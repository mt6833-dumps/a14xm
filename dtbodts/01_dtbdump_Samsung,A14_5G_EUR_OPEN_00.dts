/dts-v1/;

/ {
	compatible = "Samsung,A14 5G EUR OPEN 00", "Mediatek,MT6833";
	dtbo-hw_rev = <0x0>;
	dtbo-hw_rev_end = <0x20>;

	__fixups__ {
		accdet = "/fragment@18:target:0";
		auxadc = "/fragment@5/__overlay__:io-channels:0", "/fragment@33:target:0", "/fragment@34/__overlay__:io-channels:0";
		bat_gm30 = "/fragment@5:target:0";
		camera_af_hw_node = "/fragment@32:target:0";
		charger = "/fragment@7:target:0";
		chosen = "/fragment@0:target:0";
		dispsys_config = "/fragment@11:target:0";
		dsi0 = "/fragment@12:target:0";
		dsi_te = "/fragment@51:target:0";
		finger_fp = "/fragment@25:target:0";
		fpc1020_fp = "/fragment@27:target:0";
		gpio = "/fragment@47:target:0";
		gpio_usage_mapping = "/fragment@46:target:0";
		gps = "/fragment@23:target:0";
		i2c0 = "/fragment@36:target:0";
		i2c1 = "/fragment@37:target:0";
		i2c2 = "/fragment@31:target:0", "/fragment@38:target:0";
		i2c3 = "/fragment@39:target:0";
		i2c4 = "/fragment@30:target:0", "/fragment@40:target:0";
		i2c5 = "/fragment@41:target:0";
		i2c6 = "/fragment@42:target:0", "/fragment@57:target:0";
		i2c7 = "/fragment@43:target:0";
		i2c8 = "/fragment@44:target:0";
		i2c9 = "/fragment@21:target:0", "/fragment@45:target:0";
		kd_camera_hw1 = "/fragment@29:target:0", "/fragment@55:target:0";
		keypad = "/fragment@13:target:0", "/fragment@56:target:0";
		lk_charger = "/fragment@4:target:0";
		md1_sim1_hot_plug_eint = "/fragment@52:target:0";
		md_auxadc = "/fragment@34:target:0";
		mrdump_ext_rst = "/fragment@48:target:0";
		mt6360_pmic = "/fragment@2:target:0";
		mt6360_pmu = "/fragment@1:target:0", "/fragment@6:target:0";
		mt6360_typec = "/fragment@3:target:0";
		mt_pmic_vcamio_ldo_reg = "/fragment@29/__overlay__:cam0_vcamio-supply:0", "/fragment@29/__overlay__:cam1_vcamio-supply:0", "/fragment@29/__overlay__:cam2_vcamio-supply:0", "/fragment@29/__overlay__:cam4_vcamio-supply:0", "/fragment@53:target:0", "/fragment@55/__overlay__:vcamio-supply:0", "/fragment@55/__overlay__:vcamio_sub-supply:0", "/fragment@55/__overlay__:vcamio_main2-supply:0", "/fragment@55/__overlay__:vcamd_sub2-supply:0";
		mt_pmic_vfp_ldo_reg = "/fragment@24/__overlay__/fingerprint@0:fp_vdd-supply:0", "/fragment@24/__overlay__/fingerprint@2:fp_vdd-supply:0", "/fragment@25/__overlay__:fp_vdd-supply:0", "/fragment@27/__overlay__:vfp-supply:0";
		mt_pmic_vtp_ldo_reg = "/fragment@29/__overlay__:cam0_vcamaf-supply:0", "/fragment@32/__overlay__:camaf_m1_pmic-supply:0", "/fragment@54:target:0", "/fragment@55/__overlay__:vcamaf-supply:0";
		mtkfb = "/fragment@10:target:0";
		odm = "/fragment@19:target:0";
		pio = "/fragment@1/__overlay__:mt6360,intr_gpio:0", "/fragment@3/__overlay__:mt6360pd,intr_gpio:0", "/fragment@7/__overlay__:afc_switch_gpio:0", "/fragment@7/__overlay__:afc_data_gpio:0", "/fragment@8:target:0", "/fragment@9:target:0", "/fragment@12/__overlay__/panel1@0:reset-gpios:0", "/fragment@12/__overlay__/panel1@0:bias-gpios:0", "/fragment@12/__overlay__/panel1@0:bias-gpios:12", "/fragment@12/__overlay__/panel2@0:reset-gpios:0", "/fragment@12/__overlay__/panel2@0:bias-gpios:0", "/fragment@12/__overlay__/panel2@0:bias-gpios:12", "/fragment@12/__overlay__/panel3@0:reset-gpios:0", "/fragment@12/__overlay__/panel3@0:bias-gpios:0", "/fragment@12/__overlay__/panel3@0:bias-gpios:12", "/fragment@12/__overlay__/panel4@0:reset-gpios:0", "/fragment@12/__overlay__/panel4@0:bias-gpios:0", "/fragment@12/__overlay__/panel4@0:bias-gpios:12", "/fragment@12/__overlay__/panel5@0:reset-gpios:0", "/fragment@12/__overlay__/panel5@0:bias-gpios:0", "/fragment@12/__overlay__/panel5@0:bias-gpios:12", "/fragment@12/__overlay__/panel6@0:reset-gpios:0", "/fragment@12/__overlay__/panel6@0:bias-gpios:0", "/fragment@12/__overlay__/panel6@0:bias-gpios:12", "/fragment@14:target:0", "/fragment@16/__overlay__:interrupt-parent:0", "/fragment@17:target:0", "/fragment@20:target:0", "/fragment@21/__overlay__/sar_hx9035@1b:interrupt-parent:0", "/fragment@21/__overlay__/sar_hx9035@1b:tyhx,irq-gpio:0", "/fragment@21/__overlay__/Semtech_sx937x@2C:interrupt-parent:0", "/fragment@21/__overlay__/Semtech_sx937x@2C:Semtech,nirq-gpio:0", "/fragment@22:target:0", "/fragment@25/__overlay__:int-gpios:0", "/fragment@25/__overlay__:interrupt-parent:0", "/fragment@26:target:0", "/fragment@27/__overlay__:fpc_rst:0", "/fragment@27/__overlay__:fpc_irq:0", "/fragment@27/__overlay__:interrupt-parent:0", "/fragment@28:target:0", "/fragment@39/__overlay__/nfc-nxp@28:nxp,pn553-irq:0", "/fragment@39/__overlay__/nfc-nxp@28:nxp,pn553-fw-dwnld:0", "/fragment@39/__overlay__/nfc-nxp@28:nxp,pn553-ven:0", "/fragment@42/__overlay__/fs16xx@34:fsm,rst-gpio:0", "/fragment@46/__overlay__:GPIO_FDD_BAND_SUPPORT_DETECT_1ST_PIN:0", "/fragment@46/__overlay__:GPIO_FDD_BAND_SUPPORT_DETECT_2ND_PIN:0", "/fragment@46/__overlay__:GPIO_FDD_BAND_SUPPORT_DETECT_3RD_PIN:0", "/fragment@46/__overlay__:GPIO_FDD_BAND_SUPPORT_DETECT_4TH_PIN:0", "/fragment@46/__overlay__:GPIO_FDD_BAND_SUPPORT_DETECT_5TH_PIN:0", "/fragment@46/__overlay__:GPIO_SIM1_HOT_PLUG:0", "/fragment@46/__overlay__:GPIO_SIM2_HOT_PLUG:0", "/fragment@46/__overlay__:GPIO_SIM2_SCLK:0", "/fragment@46/__overlay__:GPIO_SIM2_SRST:0", "/fragment@46/__overlay__:GPIO_SIM2_SIO:0", "/fragment@46/__overlay__:GPIO_SIM1_SIO:0", "/fragment@46/__overlay__:GPIO_SIM1_SRST:0", "/fragment@46/__overlay__:GPIO_SIM1_SCLK:0", "/fragment@46/__overlay__:GPIO_RF_PWREN_RST_PIN:0", "/fragment@48/__overlay__:interrupt-parent:0", "/fragment@48/__overlay__:deb-gpios:0", "/fragment@49/__overlay__:interrupt-parent:0", "/fragment@50/__overlay__:interrupt-parent:0", "/fragment@51/__overlay__:interrupt-parent:0", "/fragment@57/__overlay__/fs16xx@34:fsm,rst-gpio:0";
		pmic_clock_buffer_ctrl = "/fragment@35:target:0";
		spi1 = "/fragment@15:target:0";
		spi5 = "/fragment@24:target:0";
		subpmic_pmu_eint = "/fragment@49:target:0";
		touch = "/fragment@16:target:0", "/fragment@50:target:0";
	};

	__local_fixups__ {

		fragment@10 {

			__overlay__ {
				pinctrl-0 = <0x0>;
				pinctrl-1 = <0x0>;
				pinctrl-2 = <0x0>;
				pinctrl-3 = <0x0>;
				pinctrl-4 = <0x0>;
				pinctrl-5 = <0x0>;
				pinctrl-6 = <0x0>;
			};
		};

		fragment@11 {

			__overlay__ {
				pinctrl-0 = <0x0>;
				pinctrl-1 = <0x0>;
				pinctrl-2 = <0x0>;
			};
		};

		fragment@12 {

			__overlay__ {

				panel1@0 {

					port {

						endpoint {
							remote-endpoint = <0x0>;
						};
					};
				};

				panel2@0 {

					port {

						endpoint {
							remote-endpoint = <0x0>;
						};
					};
				};

				panel3@0 {

					port {

						endpoint {
							remote-endpoint = <0x0>;
						};
					};
				};

				panel4@0 {

					port {

						endpoint {
							remote-endpoint = <0x0>;
						};
					};
				};

				panel5@0 {

					port {

						endpoint {
							remote-endpoint = <0x0>;
						};
					};
				};

				panel6@0 {

					port {

						endpoint {
							remote-endpoint = <0x0>;
						};
					};
				};

				ports {

					port {

						endpoint {
							remote-endpoint = <0x0>;
						};
					};
				};
			};
		};

		fragment@13 {

			__overlay__ {
				pinctrl-0 = <0x0>;
			};
		};

		fragment@16 {

			__overlay__ {
				pinctrl-0 = <0x0>;
				pinctrl-1 = <0x0>;
				pinctrl-2 = <0x0>;
				pinctrl-3 = <0x0>;
				pinctrl-4 = <0x0>;
				pinctrl-5 = <0x0>;
			};
		};

		fragment@21 {

			__overlay__ {

				Semtech_sx937x@2C {
					pinctrl-0 = <0x0>;
				};

				sar_hx9035@1b {
					pinctrl-0 = <0x0>;
				};
			};
		};

		fragment@23 {

			__overlay__ {
				pinctrl-0 = <0x0>;
				pinctrl-1 = <0x0>;
				pinctrl-2 = <0x0>;
				pinctrl-3 = <0x0>;
				pinctrl-4 = <0x0>;
				pinctrl-5 = <0x0>;
				pinctrl-6 = <0x0>;
			};
		};

		fragment@25 {

			__overlay__ {
				pinctrl-0 = <0x0>;
				pinctrl-1 = <0x0>;
				pinctrl-2 = <0x0>;
				pinctrl-3 = <0x0>;
				pinctrl-4 = <0x0>;
				pinctrl-5 = <0x0>;
			};
		};

		fragment@29 {

			__overlay__ {
				pinctrl-0 = <0x0>;
				pinctrl-1 = <0x0>;
				pinctrl-10 = <0x0>;
				pinctrl-11 = <0x0>;
				pinctrl-12 = <0x0>;
				pinctrl-13 = <0x0>;
				pinctrl-14 = <0x0>;
				pinctrl-15 = <0x0>;
				pinctrl-16 = <0x0>;
				pinctrl-17 = <0x0>;
				pinctrl-18 = <0x0>;
				pinctrl-19 = <0x0>;
				pinctrl-2 = <0x0>;
				pinctrl-20 = <0x0>;
				pinctrl-21 = <0x0>;
				pinctrl-22 = <0x0>;
				pinctrl-23 = <0x0>;
				pinctrl-24 = <0x0>;
				pinctrl-25 = <0x0>;
				pinctrl-26 = <0x0>;
				pinctrl-27 = <0x0>;
				pinctrl-28 = <0x0>;
				pinctrl-29 = <0x0>;
				pinctrl-3 = <0x0>;
				pinctrl-30 = <0x0>;
				pinctrl-31 = <0x0>;
				pinctrl-32 = <0x0>;
				pinctrl-33 = <0x0>;
				pinctrl-34 = <0x0>;
				pinctrl-35 = <0x0>;
				pinctrl-36 = <0x0>;
				pinctrl-37 = <0x0>;
				pinctrl-38 = <0x0>;
				pinctrl-39 = <0x0>;
				pinctrl-4 = <0x0>;
				pinctrl-40 = <0x0>;
				pinctrl-41 = <0x0>;
				pinctrl-42 = <0x0>;
				pinctrl-43 = <0x0>;
				pinctrl-44 = <0x0>;
				pinctrl-45 = <0x0>;
				pinctrl-46 = <0x0>;
				pinctrl-47 = <0x0>;
				pinctrl-48 = <0x0>;
				pinctrl-49 = <0x0>;
				pinctrl-5 = <0x0>;
				pinctrl-50 = <0x0>;
				pinctrl-6 = <0x0>;
				pinctrl-7 = <0x0>;
				pinctrl-8 = <0x0>;
				pinctrl-9 = <0x0>;
			};
		};

		fragment@7 {

			__overlay__ {
				pinctrl-0 = <0x0>;
				pinctrl-1 = <0x0>;
			};
		};
	};

	__symbols__ {
		afc_disable_pin = "/fragment@8/__overlay__/sleep";
		afc_enable_pin = "/fragment@8/__overlay__/active";
		cam1_rst_en0 = "/fragment@28/__overlay__/cam1_rst_en0";
		cam1_rst_en1 = "/fragment@28/__overlay__/cam1_rst_en1";
		cam1_vcamd_1v1_en1 = "/fragment@28/__overlay__/cam1_vcamd_1v1_en1";
		cam1_vcamd_1v2_en0 = "/fragment@28/__overlay__/cam1_vcamd_1v2_en0";
		cam1_vcamd_en0 = "/fragment@28/__overlay__/cam1_vcamd_en0";
		cam1_vcamd_en1 = "/fragment@28/__overlay__/cam1_vcamd_en1";
		camera_main_af_mtk = "/fragment@38/__overlay__/camera_main_af@72";
		camera_main_eeprom_mtk = "/fragment@38/__overlay__/camera_main_eeprom@1a";
		camera_main_mtk = "/fragment@38/__overlay__/camera_main@1a";
		camera_main_three_mtk = "/fragment@45/__overlay__/camera_main_three@10";
		camera_main_two_af_mtk = "/fragment@40/__overlay__/camera_main_two_af@0c";
		camera_main_two_mtk = "/fragment@44/__overlay__/camera_main_two@10";
		camera_pins_cam0_mclk_2ma = "/fragment@28/__overlay__/camera_pins_cam0_mclk_2ma";
		camera_pins_cam0_mclk_4ma = "/fragment@28/__overlay__/camera_pins_cam0_mclk_4ma";
		camera_pins_cam0_mclk_6ma = "/fragment@28/__overlay__/camera_pins_cam0_mclk_6ma";
		camera_pins_cam0_mclk_8ma = "/fragment@28/__overlay__/camera_pins_cam0_mclk_8ma";
		camera_pins_cam0_mclk_off = "/fragment@28/__overlay__/camera_pins_cam0_mclk_off";
		camera_pins_cam0_rst_0 = "/fragment@28/__overlay__/cam0@0";
		camera_pins_cam0_rst_1 = "/fragment@28/__overlay__/cam0@1";
		camera_pins_cam0_vcama_0 = "/fragment@28/__overlay__/cam0@vcam2";
		camera_pins_cam0_vcama_1 = "/fragment@28/__overlay__/cam0@vcam3";
		camera_pins_cam0_vcamd_0 = "/fragment@28/__overlay__/cam0@vcam0";
		camera_pins_cam0_vcamd_1 = "/fragment@28/__overlay__/cam0@vcam1";
		camera_pins_cam0_vcamd_1v2_0 = "/fragment@28/__overlay__/cam0@vcam6";
		camera_pins_cam0_vcamd_1v2_1 = "/fragment@28/__overlay__/cam0@vcam7";
		camera_pins_cam1_mclk_2ma = "/fragment@28/__overlay__/camera_pins_cam1_mclk_2ma";
		camera_pins_cam1_mclk_4ma = "/fragment@28/__overlay__/camera_pins_cam1_mclk_4ma";
		camera_pins_cam1_mclk_6ma = "/fragment@28/__overlay__/camera_pins_cam1_mclk_6ma";
		camera_pins_cam1_mclk_8ma = "/fragment@28/__overlay__/camera_pins_cam1_mclk_8ma";
		camera_pins_cam1_mclk_off = "/fragment@28/__overlay__/camera_pins_cam1_mclk_off";
		camera_pins_cam1_rst_0 = "/fragment@28/__overlay__/cam1@0";
		camera_pins_cam1_rst_1 = "/fragment@28/__overlay__/cam1@1";
		camera_pins_cam1_vcama_0 = "/fragment@28/__overlay__/cam1@vcam2";
		camera_pins_cam1_vcama_1 = "/fragment@28/__overlay__/cam1@vcam3";
		camera_pins_cam1_vcamd_0 = "/fragment@28/__overlay__/cam1@vcam0";
		camera_pins_cam1_vcamd_1 = "/fragment@28/__overlay__/cam1@vcam1";
		camera_pins_cam1_vcamd_1v2_0 = "/fragment@28/__overlay__/cam0@vcam10";
		camera_pins_cam1_vcamd_1v2_1 = "/fragment@28/__overlay__/cam0@vcam11";
		camera_pins_cam2_mclk_2ma = "/fragment@28/__overlay__/camera_pins_cam2_mclk_2ma";
		camera_pins_cam2_mclk_4ma = "/fragment@28/__overlay__/camera_pins_cam2_mclk_4ma";
		camera_pins_cam2_mclk_6ma = "/fragment@28/__overlay__/camera_pins_cam2_mclk_6ma";
		camera_pins_cam2_mclk_8ma = "/fragment@28/__overlay__/camera_pins_cam2_mclk_8ma";
		camera_pins_cam2_mclk_off = "/fragment@28/__overlay__/camera_pins_cam2_mclk_off";
		camera_pins_cam2_pnd_0 = "/fragment@28/__overlay__/cam2@0";
		camera_pins_cam2_pnd_1 = "/fragment@28/__overlay__/cam2@1";
		camera_pins_cam2_vcama_0 = "/fragment@28/__overlay__/cam2@vcam2";
		camera_pins_cam2_vcama_1 = "/fragment@28/__overlay__/cam2@vcam3";
		camera_pins_cam4_mclk_2ma = "/fragment@28/__overlay__/camera_pins_cam4_mclk_2ma";
		camera_pins_cam4_mclk_4ma = "/fragment@28/__overlay__/camera_pins_cam4_mclk_4ma";
		camera_pins_cam4_mclk_6ma = "/fragment@28/__overlay__/camera_pins_cam4_mclk_6ma";
		camera_pins_cam4_mclk_8ma = "/fragment@28/__overlay__/camera_pins_cam4_mclk_8ma";
		camera_pins_cam4_mclk_off = "/fragment@28/__overlay__/camera_pins_cam4_mclk_off";
		camera_pins_cam4_rst_0 = "/fragment@28/__overlay__/cam4@0";
		camera_pins_cam4_rst_1 = "/fragment@28/__overlay__/cam4@1";
		camera_pins_cam4_vcama_0 = "/fragment@28/__overlay__/cam4@vcam2";
		camera_pins_cam4_vcama_1 = "/fragment@28/__overlay__/cam4@vcam3";
		camera_pins_default = "/fragment@28/__overlay__/camdefault";
		camera_sub_eeprom_mtk = "/fragment@40/__overlay__/camera_sub_eeprom@1b";
		camera_sub_mtk = "/fragment@40/__overlay__/camera_sub@1a";
		camera_sub_two_mtk = "/fragment@40/__overlay__/camera_sub_two@2a";
		ctp_pins_default = "/fragment@17/__overlay__/eint0default";
		ctp_pins_eint_as_int = "/fragment@17/__overlay__/eint1touch@0";
		ctp_pins_eint_output0 = "/fragment@17/__overlay__/eintoutput0";
		ctp_pins_eint_output1 = "/fragment@17/__overlay__/eintoutput1";
		ctp_pins_rst_output0 = "/fragment@17/__overlay__/rstoutput0";
		ctp_pins_rst_output1 = "/fragment@17/__overlay__/rstoutput1";
		dsi_out = "/fragment@12/__overlay__/ports/port/endpoint";
		fingerfp_default = "/fragment@26/__overlay__/fingerfpdefault";
		fingerfp_gpio = "/fragment@26/__overlay__/fp_gpio_default";
		fingerfp_irq = "/fragment@26/__overlay__/fp_eint@18";
		fingerfp_rst_high = "/fragment@26/__overlay__/state_reset_high";
		fingerfp_rst_low = "/fragment@26/__overlay__/state_reset_low";
		fingerfp_spi = "/fragment@26/__overlay__/fp_spi_default";
		gps_l1_lna_pins_dsp_ctrl = "/fragment@20/__overlay__/gps_l1_lna@1";
		gps_l1_lna_pins_oh = "/fragment@20/__overlay__/gps_l1_lna@2";
		gps_l1_lna_pins_ol = "/fragment@20/__overlay__/gps_l1_lna@0";
		gps_l5_lna_pins_dsp_ctrl = "/fragment@20/__overlay__/gps_l5_lna@1";
		gps_l5_lna_pins_oh = "/fragment@20/__overlay__/gps_l5_lna@2";
		gps_l5_lna_pins_ol = "/fragment@20/__overlay__/gps_l5_lna@0";
		gps_pins_default = "/fragment@20/__overlay__/gps_default";
		i2c_lcd_bias_mtk = "/fragment@42/__overlay__/i2c_lcd_bias@3E";
		kpd_pins_default = "/fragment@14/__overlay__/kpdgpiodefault";
		led0 = "/fragment@19/__overlay__/led@0";
		led1 = "/fragment@19/__overlay__/led@1";
		led2 = "/fragment@19/__overlay__/led@2";
		led3 = "/fragment@19/__overlay__/led@3";
		led4 = "/fragment@19/__overlay__/led@4";
		led5 = "/fragment@19/__overlay__/led@5";
		led6 = "/fragment@19/__overlay__/led@6";
		mtk_camera_eeprom0 = "/fragment@31/__overlay__/camera_eeprom0@50";
		mtk_camera_eeprom1 = "/fragment@30/__overlay__/camera_eeprom1@51";
		mtk_camera_eeprom4 = "/fragment@30/__overlay__/camera_eeprom4@50";
		mtkfb_pins_lcd_bias_enn0 = "/fragment@9/__overlay__/lcd_bias_enn0_gpio";
		mtkfb_pins_lcd_bias_enn1 = "/fragment@9/__overlay__/lcd_bias_enn1_gpio";
		mtkfb_pins_lcd_bias_enp0 = "/fragment@9/__overlay__/lcd_bias_enp0_gpio";
		mtkfb_pins_lcd_bias_enp1 = "/fragment@9/__overlay__/lcd_bias_enp1_gpio";
		mtkfb_pins_lcm_dsi_te = "/fragment@9/__overlay__/lcm_dsi_te";
		mtkfb_pins_lcm_rst_out0_gpio = "/fragment@9/__overlay__/lcm_rst_out0_gpio";
		mtkfb_pins_lcm_rst_out1_gpio = "/fragment@9/__overlay__/lcm_rst_out1_gpio";
		panel_in1 = "/fragment@12/__overlay__/panel1@0/port/endpoint";
		panel_in2 = "/fragment@12/__overlay__/panel2@0/port/endpoint";
		panel_in3 = "/fragment@12/__overlay__/panel3@0/port/endpoint";
		panel_in4 = "/fragment@12/__overlay__/panel4@0/port/endpoint";
		panel_in5 = "/fragment@12/__overlay__/panel5@0/port/endpoint";
		panel_in6 = "/fragment@12/__overlay__/panel6@0/port/endpoint";
		sar_int_default = "/fragment@22/__overlay__/sar_int_pin/sar_int_default";
		subpmic_ldo_mtk = "/fragment@41/__overlay__/subpmic_ldo@64";
		subpmic_mtk = "/fragment@41/__overlay__/subpmic@34";
		subpmic_pmic_mtk = "/fragment@41/__overlay__/subpmic_pmic@1a";
		usb_type_c_mtk = "/fragment@41/__overlay__/usb_type_c@4e";
		vibrator0 = "/fragment@19/__overlay__/vibrator@0";
	};

	fragment@0 {
		target = <0xffffffff>;

		__overlay__ {
			atag,videolfb-fb_base_h = <0x0>;
			atag,videolfb-fb_base_l = "~`P";
			atag,videolfb-fps = <0x1770>;
			atag,videolfb-islcm_inited = <0x0>;
			atag,videolfb-islcmfound = <0x1>;
			atag,videolfb-lcmname = "nt35595_fhd_dsi_cmd_truly_nt50358_drv";
			atag,videolfb-vramSize = <0x1be0000>;
		};
	};

	fragment@1 {
		target = <0xffffffff>;

		__overlay__ {
			mt6360,intr_gpio = <0xffffffff 0xa 0x0>;
			mt6360,intr_gpio_num = <0xa>;
		};
	};

	fragment@10 {
		target = <0xffffffff>;

		__overlay__ {
			pinctrl-0 = <0x3>;
			pinctrl-1 = <0x4>;
			pinctrl-2 = <0x5>;
			pinctrl-3 = <0x6>;
			pinctrl-4 = <0x7>;
			pinctrl-5 = <0x8>;
			pinctrl-6 = <0x9>;
			pinctrl-names = "lcd_bias_enp1_gpio", "lcd_bias_enp0_gpio", "lcd_bias_enn1_gpio", "lcd_bias_enn0_gpio", "lcm_rst_out1_gpio", "lcm_rst_out0_gpio", "mode_te_te";
			status = "okay";
		};
	};

	fragment@11 {
		target = <0xffffffff>;

		__overlay__ {
			pinctrl-0 = <0x7>;
			pinctrl-1 = <0x8>;
			pinctrl-2 = <0x9>;
			pinctrl-names = "lcm_rst_out1_gpio", "lcm_rst_out0_gpio", "mode_te_te";
			status = "okay";
		};
	};

	fragment@12 {
		target = <0xffffffff>;

		__overlay__ {
			#address-cells = <0x1>;
			#size-cells = <0x0>;
			status = "okay";

			panel1@0 {
				bias-gpios = <0xffffffff 0x89 0x0 0xffffffff 0x8a 0x0>;
				compatible = "wt,ft8722_fhdp_wt_dsi_vdo_cphy_90hz_txd";
				pinctrl-names = "default";
				reg = <0x0>;
				reset-gpios = <0xffffffff 0x56 0x0>;

				port {

					endpoint {
						phandle = <0xb>;
						remote-endpoint = <0xa>;
					};
				};
			};

			panel2@0 {
				bias-gpios = <0xffffffff 0x89 0x0 0xffffffff 0x8a 0x0>;
				compatible = "wt,ili7807s_fhdp_wt_dsi_vdo_cphy_90hz_tianma";
				pinctrl-names = "default";
				reg = <0x1>;
				reset-gpios = <0xffffffff 0x56 0x0>;

				port {

					endpoint {
						phandle = <0x54>;
						remote-endpoint = <0xa>;
					};
				};
			};

			panel3@0 {
				bias-gpios = <0xffffffff 0x89 0x0 0xffffffff 0x8a 0x0>;
				compatible = "wt,hx83112f_fhdp_wt_dsi_vdo_cphy_90hz_dsbj";
				pinctrl-names = "default";
				reg = <0x2>;
				reset-gpios = <0xffffffff 0x56 0x0>;

				port {

					endpoint {
						phandle = <0x55>;
						remote-endpoint = <0xa>;
					};
				};
			};

			panel4@0 {
				bias-gpios = <0xffffffff 0x89 0x0 0xffffffff 0x8a 0x0>;
				compatible = "wt,hx83112f_fhdp_wt_dsi_vdo_cphy_90hz_djn";
				pinctrl-names = "default";
				reg = <0x3>;
				reset-gpios = <0xffffffff 0x56 0x0>;

				port {

					endpoint {
						phandle = <0x56>;
						remote-endpoint = <0xa>;
					};
				};
			};

			panel5@0 {
				bias-gpios = <0xffffffff 0x89 0x0 0xffffffff 0x8a 0x0>;
				compatible = "wt,ili7807s_fhdp_wt_dsi_vdo_cphy_90hz_chuangwei";
				pinctrl-names = "default";
				reg = <0x4>;
				reset-gpios = <0xffffffff 0x56 0x0>;

				port {

					endpoint {
						phandle = <0x57>;
						remote-endpoint = <0xa>;
					};
				};
			};

			panel6@0 {
				bias-gpios = <0xffffffff 0x89 0x0 0xffffffff 0x8a 0x0>;
				compatible = "wt,virtual_dsi_vdo_default";
				pinctrl-names = "default";
				reg = <0x5>;
				reset-gpios = <0xffffffff 0x56 0x0>;

				port {

					endpoint {
						phandle = <0x58>;
						remote-endpoint = <0xa>;
					};
				};
			};

			ports {

				port {

					endpoint {
						phandle = <0xa>;
						remote-endpoint = <0xb>;
					};
				};
			};
		};
	};

	fragment@13 {
		target = <0xffffffff>;

		__overlay__ {
			pinctrl-0 = <0xc>;
			pinctrl-names = "default";
		};
	};

	fragment@14 {
		target = <0xffffffff>;

		__overlay__ {

			kpdgpiodefault {
				phandle = <0xc>;

				pins_cmd_dat {
					bias-pull-up = <0x66>;
					input-schmitt-enable;
					output-low;
					pinmux = <0x4f01>;
				};
			};
		};
	};

	fragment@15 {
		target = <0xffffffff>;

		__overlay__ {
			#address-cells = <0x1>;
			#size-cells = <0x0>;
			status = "okay";

			ft8722@0 {
				compatible = "focaltech,ft8722", "himax,common", "mediatek,7807s_touch";
				reg = <0x0>;
				spi-max-frequency = <0x927c00>;
				status = "okay";
			};
		};
	};

	fragment@16 {
		target = <0xffffffff>;

		__overlay__ {
			interrupt-parent = <0xffffffff>;
			interrupts = <0xe 0x2 0xe 0x0>;
			pinctrl-0 = <0xd>;
			pinctrl-1 = <0xe>;
			pinctrl-2 = <0xf>;
			pinctrl-3 = <0x10>;
			pinctrl-4 = <0x11>;
			pinctrl-5 = <0x12>;
			pinctrl-names = "default", "state_eint_as_int", "state_eint_output0", "state_eint_output1", "state_rst_output0", "state_rst_output1";
			status = "okay";
			tpd-filter-custom-prameters = <0x0 0x0 0x0 0x0 0x0 0x0 0x0 0x0 0x0 0x0 0x0 0x0>;
			tpd-filter-custom-speed = <0x0 0x0 0x0>;
			tpd-filter-enable = <0x0>;
			tpd-filter-pixel-density = <0x6a>;
			tpd-key-dim-local = <0x5a 0x373 0x64 0x28 0xe6 0x373 0x64 0x28 0x172 0x373 0x64 0x28 0x0 0x0 0x0 0x0>;
			tpd-key-local = <0x8b 0xac 0x9e 0x0>;
			tpd-key-num = <0x3>;
			tpd-max-touch-num = <0xa>;
			tpd-resolution = <0x438 0x960>;
			use-tpd-button = <0x0>;
		};
	};

	fragment@17 {
		target = <0xffffffff>;

		__overlay__ {

			eint0default {
				phandle = <0xd>;
			};

			eint1touch@0 {
				phandle = <0xe>;

				pins_cmd_dat {
					input-enable;
					pinmux = <0xe00>;
				};
			};

			eintoutput0 {
				phandle = <0xf>;

				pins_cmd_dat {
					output-low;
					pinmux = <0xe00>;
				};
			};

			eintoutput1 {
				phandle = <0x10>;

				pins_cmd_dat {
					output-high;
					pinmux = <0xe00>;
				};
			};

			rstoutput0 {
				phandle = <0x11>;

				pins_cmd_dat {
					output-low;
					pinmux = <0xf00>;
				};
			};

			rstoutput1 {
				phandle = <0x12>;

				pins_cmd_dat {
					output-high;
					pinmux = <0xf00>;
				};
			};
		};
	};

	fragment@18 {
		target = <0xffffffff>;

		__overlay__ {
			accdet-mic-mode = <0x2>;
			accdet-mic-vol = <0x8>;
			accdet-plugout-debounce = <0x1>;
			eint_use_ext_res = <0x0>;
			headset-four-key-threshold = <0x0 0x3a 0x79 0xc0 0x190>;
			headset-mode-setting = <0x500 0x500 0x1 0x1f0 0x1000 0x1000 0xc80 0x44 0x4 0x1 0x5 0x3 0x3 0x5 0xe>;
			headset-three-key-threshold = <0x0 0x50 0xdc 0x190>;
			headset-three-key-threshold-CDD = <0x0 0x79 0xc0 0x258>;
			headset-vol-threshold = <0x0 0x15e 0x15f 0x62c 0x6a4>;
			status = "okay";
		};
	};

	fragment@19 {
		target = <0xffffffff>;

		__overlay__ {

			led@0 {
				compatible = "mediatek,red";
				data = <0x1>;
				led_mode = <0x0>;
				phandle = <0x59>;
				pwm_config = <0x0 0x0 0x0 0x0 0x0>;
			};

			led@1 {
				compatible = "mediatek,green";
				data = <0x1>;
				led_mode = <0x0>;
				phandle = <0x5a>;
				pwm_config = <0x0 0x0 0x0 0x0 0x0>;
			};

			led@2 {
				compatible = "mediatek,blue";
				data = <0x1>;
				led_mode = <0x0>;
				phandle = <0x5b>;
				pwm_config = <0x0 0x0 0x0 0x0 0x0>;
			};

			led@3 {
				compatible = "mediatek,jogball-backlight";
				data = <0x1>;
				led_mode = <0x0>;
				phandle = <0x5c>;
				pwm_config = <0x0 0x0 0x0 0x0 0x0>;
			};

			led@4 {
				compatible = "mediatek,keyboard-backlight";
				data = <0x1>;
				led_mode = <0x0>;
				phandle = <0x5d>;
				pwm_config = <0x0 0x0 0x0 0x0 0x0>;
			};

			led@5 {
				compatible = "mediatek,button-backlight";
				data = <0x1>;
				led_mode = <0x0>;
				phandle = <0x5e>;
				pwm_config = <0x0 0x0 0x0 0x0 0x0>;
			};

			led@6 {
				compatible = "mediatek,lcd-backlight";
				data = <0x1>;
				led_mode = <0x4>;
				phandle = <0x5f>;
				pwm_config = <0x0 0x1 0x0 0x0 0x0>;
			};

			vibrator@0 {
				compatible = "mediatek,vibrator";
				phandle = <0x60>;
				vib_limit = <0x9>;
				vib_timer = <0x19>;
				vib_vol = <0xd>;
			};
		};
	};

	fragment@2 {
		target = <0xffffffff>;

		__overlay__ {
			pwr_off_seq = <0x4000002>;
		};
	};

	fragment@20 {
		target = <0xffffffff>;

		__overlay__ {

			gps_default {
				phandle = <0x14>;
			};

			gps_l1_lna@0 {
				phandle = <0x15>;

				pins_cmd_dat {
					output-low;
					pinmux = <0x8c00>;
				};
			};

			gps_l1_lna@1 {
				phandle = <0x16>;

				pins_cmd_dat {
					output-low;
					pinmux = <0x8c01>;
				};
			};

			gps_l1_lna@2 {
				phandle = <0x17>;

				pins_cmd_dat {
					output-high;
					pinmux = <0x8c00>;
				};
			};

			gps_l5_lna@0 {
				phandle = <0x18>;

				pins_cmd_dat {
					output-low;
					pinmux = <0x5b00>;
				};
			};

			gps_l5_lna@1 {
				phandle = <0x19>;

				pins_cmd_dat {
					pinmux = <0x5b04>;
				};
			};

			gps_l5_lna@2 {
				phandle = <0x1a>;

				pins_cmd_dat {
					output-high;
					pinmux = <0x5b00>;
				};
			};
		};
	};

	fragment@21 {
		target = <0xffffffff>;

		__overlay__ {
			status = "okay";

			Semtech_sx937x@2C {
				Semtech,button-flag = <0x7>;
				Semtech,nirq-gpio = <0xffffffff 0xc 0x0>;
				Semtech,ref-phases-a = <0x3>;
				Semtech,ref-phases-b = <0x4>;
				Semtech,ref-phases-c = <0x5>;
				Semtech,reg-init = <0x8024 0x7f00 0x4004 0x70 0x4008 0x8 0x8020 0x32 0x8028 0x846 0x8034 0x846 0x8040 0x446 0x804c 0xd46 0x8058 0x846 0x8064 0x446 0x8070 0x846 0x807c 0x88e 0x8030 0xfff9fd 0x803c 0xf7f9ff 0x8048 0xffd9ff 0x8054 0xfff9ef 0x8060 0xfef9ff 0x806c 0xbff9ff 0x8078 0xffffff 0x8084 0xffffff 0x8098 0x60 0x80b8 0x39 0x80d8 0x1a 0x80f8 0xff 0x8118 0xff 0x8138 0xff 0x8158 0xff 0x80a0 0x80800001 0x80c0 0x20200002 0x80e0 0x10100003 0x8188 0x8000013 0x818c 0x8000014 0x8190 0x8000015 0x8090 0x54ac5000 0x80b0 0x54ac5000 0x80d0 0x54a75000 0x80f0 0x5300 0x8110 0x5300 0x8130 0x5300 0x8150 0x5300 0x8170 0x2ad66000 0x8088 0x300005 0x80a8 0x300005 0x80c8 0x300005 0x80e8 0x6300000 0x8108 0x6300000 0x8128 0x6300000 0x8148 0x6300000 0x8168 0x300000 0x808c 0x60200078 0x80ac 0x60200078 0x80cc 0x60200078 0x80ec 0x60200030 0x810c 0x60200030 0x812c 0x60200030 0x814c 0x60200030 0x816c 0x60200030 0x8274 0x2e040000 0x4280 0xe>;
				Semtech,reg-num = <0x3b>;
				compatible = "Semtech,sx937x";
				interrupt-parent = <0xffffffff>;
				interrupts = <0xc 0x2 0xc 0x0>;
				pinctrl-0 = <0x13>;
				pinctrl-names = "sar_int_default";
				reg = <0x2c>;
				status = "okay";
			};

			sar_hx9035@1b {
				compatible = "tyhx,hx9035";
				grip-sensor = <0x0>;
				grip-sensor-sub = <0x1>;
				grip-sensor-wifi = <0x2>;
				i2c_num = <0x1>;
				interrupt-parent = <0xffffffff>;
				interrupts = <0xc 0x2 0xc 0x0>;
				pinctrl-0 = <0x13>;
				pinctrl-names = "sar_int_default";
				reg = <0x1b>;
				status = "okay";
				tyhx,button-flag = <0xff>;
				tyhx,channel-flag = <0xff>;
				tyhx,irq-flags = <0x2>;
				tyhx,irq-gpio = <0xffffffff 0xc 0x0>;
			};
		};
	};

	fragment@22 {
		target = <0xffffffff>;

		__overlay__ {

			sar_int_pin {

				sar_int_default {
					bias-pull-up;
					phandle = <0x13>;
					pinmux = <0xc00>;
					slew-rate = <0x2>;
				};
			};
		};
	};

	fragment@23 {
		target = <0xffffffff>;

		__overlay__ {
			pinctrl-0 = <0x14>;
			pinctrl-1 = <0x15>;
			pinctrl-2 = <0x16>;
			pinctrl-3 = <0x17>;
			pinctrl-4 = <0x18>;
			pinctrl-5 = <0x19>;
			pinctrl-6 = <0x1a>;
			pinctrl-names = "default", "gps_l1_lna_disable", "gps_l1_lna_dsp_ctrl", "gps_l1_lna_enable", "gps_l5_lna_disable", "gps_l5_lna_dsp_ctrl", "gps_l5_lna_enable";
			status = "okay";
		};
	};

	fragment@24 {
		target = <0xffffffff>;

		__overlay__ {
			#address-cells = <0x1>;
			#size-cells = <0x0>;

			fingerprint@0 {
				compatible = "mediatek,finger-chipone";
				fp_vdd-supply = <0xffffffff>;
				netlink-event = <0x1e>;
				reg = <0x0>;
				spi-max-frequency = <0x7a1200>;
				status = "okay";
			};

			fingerprint@2 {
				compatible = "sil,silead_fp";
				fp_vdd-supply = <0xffffffff>;
				netlink-event = <0x1e>;
				reg = <0x2>;
				spi-max-frequency = <0x7a1200>;
				status = "okay";
			};

			fpc@1 {
				compatible = "fpc,fpc1020";
				reg = <0x1>;
				spi-max-frequency = <0x4c4b40>;
				status = "okay";
			};
		};
	};

	fragment@25 {
		target = <0xffffffff>;

		__overlay__ {
			fp-ctrl-power;
			fp_vdd-supply = <0xffffffff>;
			int-gpios = <0xffffffff 0x12 0x0>;
			interrupt-parent = <0xffffffff>;
			interrupts = <0x12 0x1 0x12 0x0>;
			pinctrl-0 = <0x1b>;
			pinctrl-1 = <0x1c>;
			pinctrl-2 = <0x1d>;
			pinctrl-3 = <0x1e>;
			pinctrl-4 = <0x1f>;
			pinctrl-5 = <0x20>;
			pinctrl-names = "default", "rst-low", "rst-high", "irq-init", "spi-default", "gpio-default";
			status = "okay";
		};
	};

	fragment@26 {
		target = <0xffffffff>;

		__overlay__ {

			fingerfpdefault {
				phandle = <0x1b>;
			};

			fp_eint@18 {
				phandle = <0x1e>;

				pins_cmd_dat {
					bias-disable;
					pinmux = <0x1200>;
					slew-rate = <0x0>;
				};
			};

			fp_gpio_default {
				phandle = <0x20>;

				pins_cmd2_dat {
					bias-pull-down;
					pinmux = <0x2300>;
					slew-rate = <0x1>;
				};

				pins_cmd3_dat {
					bias-pull-down;
					pinmux = <0x2600>;
					slew-rate = <0x0>;
				};

				pins_cmd4_dat {
					bias-pull-down;
					pinmux = <0x2500>;
					slew-rate = <0x1>;
				};

				pins_cmd_dat {
					bias-pull-up;
					pinmux = <0x2400>;
					slew-rate = <0x1>;
				};
			};

			fp_spi_default {
				phandle = <0x1f>;

				pins_cmd2_dat {
					bias-pull-down;
					pinmux = <0x2301>;
					slew-rate = <0x1>;
				};

				pins_cmd3_dat {
					bias-pull-down;
					pinmux = <0x2601>;
					slew-rate = <0x0>;
				};

				pins_cmd4_dat {
					bias-pull-down;
					pinmux = <0x2501>;
					slew-rate = <0x1>;
				};

				pins_cmd_dat {
					bias-pull-up;
					pinmux = <0x2401>;
					slew-rate = <0x1>;
				};
			};

			state_reset_high {
				phandle = <0x1d>;

				pins_cmd_dat {
					output-high;
					pinmux = <0x1100>;
					slew-rate = <0x1>;
				};
			};

			state_reset_low {
				phandle = <0x1c>;

				pins_cmd_dat {
					output-low;
					pinmux = <0x1100>;
					slew-rate = <0x1>;
				};
			};
		};
	};

	fragment@27 {
		target = <0xffffffff>;

		__overlay__ {
			fpc_irq = <0xffffffff 0x12 0x0>;
			fpc_rst = <0xffffffff 0x11 0x0>;
			interrupt-parent = <0xffffffff>;
			interrupts = <0x12 0x1 0x12 0x0>;
			status = "okay";
			vfp-supply = <0xffffffff>;
		};
	};

	fragment@28 {
		target = <0xffffffff>;

		__overlay__ {

			cam0@0 {
				phandle = <0x22>;

				pins_cmd_dat {
					output-low;
					pinmux = <0x3600>;
					slew-rate = <0x1>;
				};
			};

			cam0@1 {
				phandle = <0x23>;

				pins_cmd_dat {
					output-high;
					pinmux = <0x3600>;
					slew-rate = <0x1>;
				};
			};

			cam0@vcam0 {
				phandle = <0x2a>;

				pins_cmd_dat {
					output-low;
					pinmux = <0xba00>;
					slew-rate = <0x1>;
				};
			};

			cam0@vcam1 {
				phandle = <0x2b>;

				pins_cmd_dat {
					output-high;
					pinmux = <0xba00>;
					slew-rate = <0x1>;
				};
			};

			cam0@vcam10 {
				phandle = <0x4c>;

				pins_cmd_dat {
					output-low;
					pinmux = <0xb900>;
					slew-rate = <0x1>;
				};
			};

			cam0@vcam11 {
				phandle = <0x4d>;

				pins_cmd_dat {
					output-high;
					pinmux = <0xb900>;
					slew-rate = <0x1>;
				};
			};

			cam0@vcam2 {
				phandle = <0x2c>;

				pins_cmd_dat {
					output-low;
					pinmux = <0xb600>;
					slew-rate = <0x1>;
				};
			};

			cam0@vcam3 {
				phandle = <0x2d>;

				pins_cmd_dat {
					output-high;
					pinmux = <0xb600>;
					slew-rate = <0x1>;
				};
			};

			cam0@vcam6 {
				phandle = <0x4a>;

				pins_cmd_dat {
					output-low;
					pinmux = <0xb900>;
					slew-rate = <0x1>;
				};
			};

			cam0@vcam7 {
				phandle = <0x4b>;

				pins_cmd_dat {
					output-high;
					pinmux = <0xb900>;
					slew-rate = <0x1>;
				};
			};

			cam1@0 {
				phandle = <0x24>;

				pins_cmd_dat {
					output-low;
					pinmux = <0x3500>;
					slew-rate = <0x1>;
				};
			};

			cam1@1 {
				phandle = <0x25>;

				pins_cmd_dat {
					output-high;
					pinmux = <0x3500>;
					slew-rate = <0x1>;
				};
			};

			cam1@vcam0 {
				phandle = <0x2e>;

				pins_cmd_dat {
					output-low;
					pinmux = <0xba00>;
					slew-rate = <0x1>;
				};
			};

			cam1@vcam1 {
				phandle = <0x2f>;

				pins_cmd_dat {
					output-high;
					pinmux = <0xba00>;
					slew-rate = <0x1>;
				};
			};

			cam1@vcam2 {
				phandle = <0x30>;

				pins_cmd_dat {
					output-low;
					pinmux = <0xb600>;
					slew-rate = <0x1>;
				};
			};

			cam1@vcam3 {
				phandle = <0x31>;

				pins_cmd_dat {
					output-high;
					pinmux = <0xb600>;
					slew-rate = <0x1>;
				};
			};

			cam1_rst_en0 {
				phandle = <0x52>;

				pins_cmd_dat {
					output-low;
					pinmux = <0x3500>;
					slew-rate = <0x1>;
				};
			};

			cam1_rst_en1 {
				phandle = <0x53>;

				pins_cmd_dat {
					output-high;
					pinmux = <0x3500>;
					slew-rate = <0x1>;
				};
			};

			cam1_vcamd_1v1_en1 {
				phandle = <0x4f>;

				pins_cmd_dat {
					output-high;
					pinmux = <0xb900>;
					slew-rate = <0x1>;
				};
			};

			cam1_vcamd_1v2_en0 {
				phandle = <0x4e>;

				pins_cmd_dat {
					output-low;
					pinmux = <0xb900>;
					slew-rate = <0x1>;
				};
			};

			cam1_vcamd_en0 {
				phandle = <0x50>;

				pins_cmd_dat {
					output-low;
					pinmux = <0xba00>;
					slew-rate = <0x1>;
				};
			};

			cam1_vcamd_en1 {
				phandle = <0x51>;

				pins_cmd_dat {
					output-high;
					pinmux = <0xba00>;
					slew-rate = <0x1>;
				};
			};

			cam2@0 {
				phandle = <0x26>;

				pins_cmd_dat {
					output-low;
					pinmux = <0x3c00>;
					slew-rate = <0x1>;
				};
			};

			cam2@1 {
				phandle = <0x27>;

				pins_cmd_dat {
					output-high;
					pinmux = <0x3c00>;
					slew-rate = <0x1>;
				};
			};

			cam2@vcam2 {
				phandle = <0x32>;

				pins_cmd_dat {
					output-low;
					pinmux = <0xb600>;
					slew-rate = <0x1>;
				};
			};

			cam2@vcam3 {
				phandle = <0x33>;

				pins_cmd_dat {
					output-high;
					pinmux = <0xb600>;
					slew-rate = <0x1>;
				};
			};

			cam4@0 {
				phandle = <0x28>;

				pins_cmd_dat {
					output-low;
					pinmux = <0x3b00>;
					slew-rate = <0x1>;
				};
			};

			cam4@1 {
				phandle = <0x29>;

				pins_cmd_dat {
					output-high;
					pinmux = <0x3b00>;
					slew-rate = <0x1>;
				};
			};

			cam4@vcam2 {
				phandle = <0x34>;

				pins_cmd_dat {
					output-low;
					pinmux = <0xb600>;
					slew-rate = <0x1>;
				};
			};

			cam4@vcam3 {
				phandle = <0x35>;

				pins_cmd_dat {
					output-high;
					pinmux = <0xb600>;
					slew-rate = <0x1>;
				};
			};

			camdefault {
				phandle = <0x21>;
			};

			camera_pins_cam0_mclk_2ma {
				phandle = <0x37>;

				pins_cmd_dat {
					drive-strength = <0x0>;
					pinmux = <0x3101>;
				};
			};

			camera_pins_cam0_mclk_4ma {
				phandle = <0x38>;

				pins_cmd_dat {
					drive-strength = <0x1>;
					pinmux = <0x3101>;
				};
			};

			camera_pins_cam0_mclk_6ma {
				phandle = <0x39>;

				pins_cmd_dat {
					drive-strength = <0x2>;
					pinmux = <0x3101>;
				};
			};

			camera_pins_cam0_mclk_8ma {
				phandle = <0x3a>;

				pins_cmd_dat {
					drive-strength = <0x3>;
					pinmux = <0x3101>;
				};
			};

			camera_pins_cam0_mclk_off {
				phandle = <0x36>;

				pins_cmd_dat {
					drive-strength = <0x1>;
					pinmux = <0x3100>;
				};
			};

			camera_pins_cam1_mclk_2ma {
				phandle = <0x3c>;

				pins_cmd_dat {
					drive-strength = <0x0>;
					pinmux = <0x3401>;
				};
			};

			camera_pins_cam1_mclk_4ma {
				phandle = <0x3d>;

				pins_cmd_dat {
					drive-strength = <0x1>;
					pinmux = <0x3401>;
				};
			};

			camera_pins_cam1_mclk_6ma {
				phandle = <0x3e>;

				pins_cmd_dat {
					drive-strength = <0x2>;
					pinmux = <0x3401>;
				};
			};

			camera_pins_cam1_mclk_8ma {
				phandle = <0x3f>;

				pins_cmd_dat {
					drive-strength = <0x3>;
					pinmux = <0x3401>;
				};
			};

			camera_pins_cam1_mclk_off {
				phandle = <0x3b>;

				pins_cmd_dat {
					drive-strength = <0x1>;
					pinmux = <0x3400>;
				};
			};

			camera_pins_cam2_mclk_2ma {
				phandle = <0x41>;

				pins_cmd_dat {
					drive-strength = <0x0>;
					pinmux = <0x3201>;
				};
			};

			camera_pins_cam2_mclk_4ma {
				phandle = <0x42>;

				pins_cmd_dat {
					drive-strength = <0x1>;
					pinmux = <0x3201>;
				};
			};

			camera_pins_cam2_mclk_6ma {
				phandle = <0x43>;

				pins_cmd_dat {
					drive-strength = <0x2>;
					pinmux = <0x3201>;
				};
			};

			camera_pins_cam2_mclk_8ma {
				phandle = <0x44>;

				pins_cmd_dat {
					drive-strength = <0x3>;
					pinmux = <0x3201>;
				};
			};

			camera_pins_cam2_mclk_off {
				phandle = <0x40>;

				pins_cmd_dat {
					drive-strength = <0x1>;
					pinmux = <0x3200>;
				};
			};

			camera_pins_cam4_mclk_2ma {
				phandle = <0x46>;

				pins_cmd_dat {
					drive-strength = <0x0>;
					pinmux = <0x3301>;
				};
			};

			camera_pins_cam4_mclk_4ma {
				phandle = <0x47>;

				pins_cmd_dat {
					drive-strength = <0x1>;
					pinmux = <0x3301>;
				};
			};

			camera_pins_cam4_mclk_6ma {
				phandle = <0x48>;

				pins_cmd_dat {
					drive-strength = <0x2>;
					pinmux = <0x3301>;
				};
			};

			camera_pins_cam4_mclk_8ma {
				phandle = <0x49>;

				pins_cmd_dat {
					drive-strength = <0x3>;
					pinmux = <0x3301>;
				};
			};

			camera_pins_cam4_mclk_off {
				phandle = <0x45>;

				pins_cmd_dat {
					drive-strength = <0x1>;
					pinmux = <0x3300>;
				};
			};
		};
	};

	fragment@29 {
		target = <0xffffffff>;

		__overlay__ {
			cam0_enable_sensor = "w2s5kjn1reartruly_mipi_raw w2s5kjn1rearst_mipi_raw w2hi5022qreartxd_mipi_raw";
			cam0_vcamaf-supply = <0xffffffff>;
			cam0_vcamio-supply = <0xffffffff>;
			cam1_enable_sensor = "w2sc1300mcsfrontst_mipi_raw w2sc1300mcsfronttxd_mipi_raw w2hi1336fronttruly_mipi_raw w2sc501csfrontsy_mipi_raw";
			cam1_vcamio-supply = <0xffffffff>;
			cam2_enable_sensor = "w2sc202csdeplh_mipi_mono w2sc202csdeplh2_mipi_mono w2c2519depcxt_mipi_mono w2c2519depcxt2_mipi_mono w2gc02m1depsj_mipi_raw";
			cam2_vcamio-supply = <0xffffffff>;
			cam3_enable_sensor = "w1_cam3_dummy_sensor_mipi_raw";
			cam4_enable_sensor = "w2sc202csmicrolh_mipi_raw w2gc02m1microcxt_mipi_raw w2bf2253lmicrosj_mipi_raw w2c2599microdelta_mipi_raw";
			cam4_vcamio-supply = <0xffffffff>;
			pinctrl-0 = <0x21>;
			pinctrl-1 = <0x22>;
			pinctrl-10 = <0x2b>;
			pinctrl-11 = <0x2c>;
			pinctrl-12 = <0x2d>;
			pinctrl-13 = <0x2e>;
			pinctrl-14 = <0x2f>;
			pinctrl-15 = <0x30>;
			pinctrl-16 = <0x31>;
			pinctrl-17 = <0x32>;
			pinctrl-18 = <0x33>;
			pinctrl-19 = <0x34>;
			pinctrl-2 = <0x23>;
			pinctrl-20 = <0x35>;
			pinctrl-21 = <0x36>;
			pinctrl-22 = <0x37>;
			pinctrl-23 = <0x38>;
			pinctrl-24 = <0x39>;
			pinctrl-25 = <0x3a>;
			pinctrl-26 = <0x3b>;
			pinctrl-27 = <0x3c>;
			pinctrl-28 = <0x3d>;
			pinctrl-29 = <0x3e>;
			pinctrl-3 = <0x24>;
			pinctrl-30 = <0x3f>;
			pinctrl-31 = <0x40>;
			pinctrl-32 = <0x41>;
			pinctrl-33 = <0x42>;
			pinctrl-34 = <0x43>;
			pinctrl-35 = <0x44>;
			pinctrl-36 = <0x45>;
			pinctrl-37 = <0x46>;
			pinctrl-38 = <0x47>;
			pinctrl-39 = <0x48>;
			pinctrl-4 = <0x25>;
			pinctrl-40 = <0x49>;
			pinctrl-41 = <0x4a>;
			pinctrl-42 = <0x4b>;
			pinctrl-43 = <0x4c>;
			pinctrl-44 = <0x4d>;
			pinctrl-45 = <0x4e>;
			pinctrl-46 = <0x4f>;
			pinctrl-47 = <0x50>;
			pinctrl-48 = <0x51>;
			pinctrl-49 = <0x52>;
			pinctrl-5 = <0x26>;
			pinctrl-50 = <0x53>;
			pinctrl-6 = <0x27>;
			pinctrl-7 = <0x28>;
			pinctrl-8 = <0x29>;
			pinctrl-9 = <0x2a>;
			pinctrl-names = "default", "cam0_rst0", "cam0_rst1", "cam1_rst0", "cam1_rst1", "cam2_pnd0", "cam2_pnd1", "cam4_rst0", "cam4_rst1", "cam0_ldo_vcamd_0", "cam0_ldo_vcamd_1", "cam0_ldo_vcama_0", "cam0_ldo_vcama_1", "cam1_ldo_vcamd_0", "cam1_ldo_vcamd_1", "cam1_ldo_vcama_0", "cam1_ldo_vcama_1", "cam2_ldo_vcama_0", "cam2_ldo_vcama_1", "cam4_ldo_vcama_0", "cam4_ldo_vcama_1", "cam0_mclk_off", "cam0_mclk_2mA", "cam0_mclk_4mA", "cam0_mclk_6mA", "cam0_mclk_8mA", "cam1_mclk_off", "cam1_mclk_2mA", "cam1_mclk_4mA", "cam1_mclk_6mA", "cam1_mclk_8mA", "cam2_mclk_off", "cam2_mclk_2mA", "cam2_mclk_4mA", "cam2_mclk_6mA", "cam2_mclk_8mA", "cam4_mclk_off", "cam4_mclk_2mA", "cam4_mclk_4mA", "cam4_mclk_6mA", "cam4_mclk_8mA", "cam0_ldo_vcamd_1v2_0", "cam0_ldo_vcamd_1v2_1", "cam1_ldo_vcamd_1v2_0", "cam1_ldo_vcamd_1v2_1", "cam1_vcamd_1v2_en0", "cam1_vcamd_1v1_en1", "cam1_vcamd_en0", "cam1_vcamd_en1", "cam1_rst_en0", "cam1_rst_en1";
			status = "okay";
		};
	};

	fragment@3 {
		target = <0xffffffff>;

		__overlay__ {
			mt6360pd,intr_gpio = <0xffffffff 0x9 0x0>;
			mt6360pd,intr_gpio_num = <0x9>;
		};
	};

	fragment@30 {
		target = <0xffffffff>;

		__overlay__ {

			camera_eeprom1@51 {
				compatible = "mediatek,camera_eeprom";
				phandle = <0x61>;
				reg = <0x51>;
				status = "okay";
			};

			camera_eeprom4@50 {
				compatible = "mediatek,camera_eeprom";
				phandle = <0x62>;
				reg = <0x50>;
				status = "okay";
			};
		};
	};

	fragment@31 {
		target = <0xffffffff>;

		__overlay__ {

			camera_eeprom0@50 {
				compatible = "mediatek,camera_eeprom";
				phandle = <0x63>;
				reg = <0x50>;
				status = "okay";
			};
		};
	};

	fragment@32 {
		target = <0xffffffff>;

		__overlay__ {
			camaf_m1_pmic-supply = <0xffffffff>;
			status = "okay";
		};
	};

	fragment@33 {
		target = <0xffffffff>;

		__overlay__ {

			adc_channel@ {
				compatible = "mediatek,adc_channel";
				mediatek,adc_fdd_rf_params_dynamic_custom_ch = <0x2>;
				mediatek,temperature0 = <0x0>;
				mediatek,temperature1 = <0x1>;
				status = "okay";
			};
		};
	};

	fragment@34 {
		target = <0xffffffff>;

		__overlay__ {
			io-channels = <0xffffffff 0x2>;
		};
	};

	fragment@35 {
		target = <0xffffffff>;

		__overlay__ {
			mediatek,clkbuf-config = <0x2 0x1 0x1 0x2 0x0 0x0 0x1>;
			mediatek,clkbuf-controls-for-desense = <0x0 0x4 0x0 0x4 0x0 0x0 0x0>;
			mediatek,clkbuf-output-impedance = <0x6 0x4 0x4 0x4 0x0 0x0 0x4>;
			mediatek,clkbuf-quantity = <0x7>;
			status = "okay";
		};
	};

	fragment@36 {
		target = <0xffffffff>;

		__overlay__ {
			#address-cells = <0x1>;
			#size-cells = <0x0>;
			clock-frequency = <0x61a80>;
			mediatek,use-open-drain;
		};
	};

	fragment@37 {
		target = <0xffffffff>;

		__overlay__ {
			#address-cells = <0x1>;
			#size-cells = <0x0>;
			clock-frequency = <0x61a80>;
			mediatek,use-open-drain;
		};
	};

	fragment@38 {
		target = <0xffffffff>;

		__overlay__ {
			#address-cells = <0x1>;
			#size-cells = <0x0>;
			clock-frequency = <0x61a80>;
			mediatek,use-open-drain;

			camera_main@1a {
				compatible = "mediatek,camera_main";
				phandle = <0x64>;
				reg = <0x1a>;
				status = "okay";
			};

			camera_main_af@72 {
				compatible = "mediatek,camera_main_af";
				phandle = <0x66>;
				reg = <0x72>;
				status = "okay";
			};

			camera_main_eeprom@1a {
				compatible = "mediatek,camera_main_eeprom";
				phandle = <0x65>;
				reg = <0x1a>;
				status = "okay";
			};
		};
	};

	fragment@39 {
		target = <0xffffffff>;

		__overlay__ {
			#address-cells = <0x1>;
			#size-cells = <0x0>;
			clock-frequency = <0x61a80>;
			mediatek,use-open-drain;

			nfc-nxp@28 {
				compatible = "nxp,pn553";
				nxp,pn553-fw-dwnld = <0xffffffff 0x6 0x0>;
				nxp,pn553-fw-dwnld_num = <0x6>;
				nxp,pn553-irq = <0xffffffff 0x5 0x0>;
				nxp,pn553-irq_num = <0x5>;
				nxp,pn553-ven = <0xffffffff 0x7 0x0>;
				nxp,pn553-ven_num = <0x1>;
				reg = <0x28>;
				status = "okay";
			};
		};
	};

	fragment@4 {
		target = <0xffffffff>;

		__overlay__ {
			ac_charger_current = <0x1e8480>;
			ac_charger_input_current = <0x1e8480>;
			ta_ac_charger_current = <0x1e8480>;
		};
	};

	fragment@40 {
		target = <0xffffffff>;

		__overlay__ {
			#address-cells = <0x1>;
			#size-cells = <0x0>;
			clock-frequency = <0x61a80>;
			mediatek,use-open-drain;

			camera_main_two_af@0c {
				compatible = "mediatek,camera_main_two_af";
				phandle = <0x6a>;
				reg = <0xc>;
				status = "okay";
			};

			camera_sub@1a {
				compatible = "mediatek,camera_sub";
				phandle = <0x67>;
				reg = <0x1a>;
				status = "okay";
			};

			camera_sub_eeprom@1b {
				compatible = "mediatek,camera_sub_eeprom";
				phandle = <0x68>;
				reg = <0x1b>;
				status = "okay";
			};

			camera_sub_two@2a {
				compatible = "mediatek,camera_sub_two";
				phandle = <0x69>;
				reg = <0x2a>;
				status = "okay";
			};
		};
	};

	fragment@41 {
		target = <0xffffffff>;

		__overlay__ {
			#address-cells = <0x1>;
			#size-cells = <0x0>;
			clock-frequency = <0x33e140>;
			mediatek,use-push-pull;

			subpmic@34 {
				compatible = "mediatek,subpmic";
				phandle = <0x6b>;
				reg = <0x34>;
				status = "okay";
			};

			subpmic_ldo@64 {
				compatible = "mediatek,subpmic_ldo";
				phandle = <0x6e>;
				reg = <0x64>;
				status = "okay";
			};

			subpmic_pmic@1a {
				compatible = "mediatek,subpmic_pmic";
				phandle = <0x6d>;
				reg = <0x1a>;
				status = "okay";
			};

			usb_type_c@4e {
				compatible = "mediatek,usb_type_c";
				phandle = <0x6c>;
				reg = <0x4e>;
				status = "okay";
			};
		};
	};

	fragment@42 {
		target = <0xffffffff>;

		__overlay__ {
			#address-cells = <0x1>;
			#size-cells = <0x0>;
			clock-frequency = <0x61a80>;
			mediatek,use-open-drain;

			fs16xx@34 {
				compatible = "foursemi,fs16xx";
				fsm,rst-gpio = <0xffffffff 0xa9 0x0>;
				reg = <0x34>;
				status = "okay";
			};

			i2c_lcd_bias@3E {
				compatible = "WT,I2C_LCD_BIAS";
				phandle = <0x6f>;
				reg = <0x3e>;
				status = "okay";
			};
		};
	};

	fragment@43 {
		target = <0xffffffff>;

		__overlay__ {
			#address-cells = <0x1>;
			#size-cells = <0x0>;
			clock-frequency = <0x61a80>;
			mediatek,use-open-drain;
		};
	};

	fragment@44 {
		target = <0xffffffff>;

		__overlay__ {
			#address-cells = <0x1>;
			#size-cells = <0x0>;
			clock-frequency = <0x61a80>;
			mediatek,use-open-drain;

			camera_main_two@10 {
				compatible = "mediatek,camera_main_two";
				phandle = <0x70>;
				reg = <0x10>;
				status = "okay";
			};
		};
	};

	fragment@45 {
		target = <0xffffffff>;

		__overlay__ {
			#address-cells = <0x1>;
			#size-cells = <0x0>;
			clock-frequency = <0x61a80>;
			mediatek,use-open-drain;

			camera_main_three@10 {
				compatible = "mediatek,camera_main_three";
				phandle = <0x71>;
				reg = <0x10>;
				status = "okay";
			};
		};
	};

	fragment@46 {
		target = <0xffffffff>;

		__overlay__ {
			GPIO_FDD_BAND_SUPPORT_DETECT_1ST_PIN = <0xffffffff 0x2c 0x0>;
			GPIO_FDD_BAND_SUPPORT_DETECT_2ND_PIN = <0xffffffff 0x2d 0x0>;
			GPIO_FDD_BAND_SUPPORT_DETECT_3RD_PIN = <0xffffffff 0x2e 0x0>;
			GPIO_FDD_BAND_SUPPORT_DETECT_4TH_PIN = <0xffffffff 0x2f 0x0>;
			GPIO_FDD_BAND_SUPPORT_DETECT_5TH_PIN = <0xffffffff 0x30 0x0>;
			GPIO_RF_PWREN_RST_PIN = <0xffffffff 0xab 0x0>;
			GPIO_SIM1_HOT_PLUG = <0xffffffff 0x4d 0x0>;
			GPIO_SIM1_SCLK = <0xffffffff 0x7c 0x0>;
			GPIO_SIM1_SIO = <0xffffffff 0x7a 0x0>;
			GPIO_SIM1_SRST = <0xffffffff 0x7b 0x0>;
			GPIO_SIM2_HOT_PLUG = <0xffffffff 0x4e 0x0>;
			GPIO_SIM2_SCLK = <0xffffffff 0x77 0x0>;
			GPIO_SIM2_SIO = <0xffffffff 0x79 0x0>;
			GPIO_SIM2_SRST = <0xffffffff 0x78 0x0>;
		};
	};

	fragment@47 {
		target = <0xffffffff>;

		__overlay__ {
			gpio_init_default = <0x0 0x0 0x0 0x0 0x1 0x0 0x1 0x1 0x0 0x0 0x0 0x1 0x1 0x1 0x2 0x0 0x0 0x0 0x1 0x1 0x1 0x3 0x0 0x0 0x0 0x1 0x0 0x1 0x4 0x0 0x0 0x0 0x1 0x1 0x1 0x5 0x0 0x0 0x0 0x1 0x0 0x1 0x6 0x0 0x1 0x0 0x1 0x0 0x1 0x7 0x0 0x1 0x0 0x1 0x0 0x1 0x8 0x7 0x0 0x0 0x1 0x0 0x1 0x9 0x0 0x1 0x0 0x1 0x1 0x1 0xa 0x0 0x0 0x0 0x1 0x1 0x1 0xb 0x0 0x0 0x0 0x1 0x1 0x1 0xc 0x0 0x0 0x0 0x1 0x0 0x1 0xd 0x2 0x0 0x0 0x1 0x0 0x1 0xe 0x0 0x0 0x0 0x1 0x1 0x1 0xf 0x0 0x1 0x0 0x1 0x0 0x1 0x10 0x7 0x0 0x0 0x1 0x0 0x1 0x11 0x0 0x1 0x0 0x1 0x0 0x1 0x12 0x0 0x0 0x0 0x1 0x0 0x1 0x13 0x7 0x0 0x0 0x0 0x0 0x1 0x14 0x7 0x0 0x0 0x1 0x0 0x1 0x15 0x7 0x0 0x0 0x1 0x0 0x1 0x16 0x7 0x0 0x0 0x1 0x0 0x1 0x17 0x7 0x0 0x0 0x1 0x0 0x1 0x18 0x7 0x0 0x0 0x1 0x0 0x1 0x19 0x7 0x0 0x0 0x1 0x0 0x1 0x1a 0x7 0x0 0x0 0x1 0x0 0x1 0x1b 0x1 0x1 0x0 0x0 0x0 0x1 0x1c 0x1 0x1 0x0 0x0 0x0 0x1 0x1d 0x1 0x1 0x0 0x0 0x0 0x1 0x1e 0x1 0x0 0x0 0x1 0x0 0x1 0x1f 0x2 0x0 0x0 0x0 0x0 0x1 0x20 0x2 0x0 0x0 0x0 0x0 0x1 0x21 0x2 0x0 0x0 0x0 0x0 0x1 0x22 0x2 0x0 0x0 0x1 0x0 0x1 0x23 0x1 0x0 0x0 0x1 0x1 0x1 0x24 0x1 0x0 0x0 0x0 0x0 0x1 0x25 0x1 0x0 0x0 0x0 0x0 0x1 0x26 0x1 0x0 0x0 0x1 0x1 0x1 0x27 0x0 0x0 0x0 0x1 0x1 0x1 0x28 0x1 0x0 0x0 0x0 0x0 0x1 0x29 0x1 0x0 0x0 0x0 0x0 0x1 0x2a 0x1 0x0 0x0 0x1 0x0 0x1 0x2b 0x1 0x0 0x0 0x0 0x0 0x1 0x2c 0x0 0x0 0x0 0x1 0x0 0x1 0x2d 0x0 0x0 0x0 0x1 0x0 0x1 0x2e 0x0 0x0 0x0 0x1 0x0 0x1 0x2f 0x0 0x0 0x0 0x1 0x0 0x1 0x30 0x0 0x0 0x0 0x1 0x0 0x1 0x31 0x1 0x0 0x0 0x0 0x0 0x1 0x32 0x1 0x0 0x0 0x0 0x0 0x1 0x33 0x1 0x0 0x0 0x0 0x0 0x1 0x34 0x1 0x0 0x0 0x0 0x0 0x1 0x35 0x0 0x1 0x0 0x1 0x0 0x1 0x36 0x0 0x1 0x0 0x1 0x0 0x1 0x37 0x0 0x1 0x0 0x1 0x0 0x1 0x38 0x0 0x1 0x0 0x1 0x0 0x1 0x39 0x0 0x0 0x0 0x1 0x0 0x1 0x3a 0x0 0x1 0x0 0x1 0x0 0x1 0x3b 0x0 0x1 0x0 0x1 0x0 0x1 0x3c 0x0 0x1 0x0 0x1 0x0 0x1 0x3d 0x1 0x0 0x0 0x1 0x1 0x1 0x3e 0x1 0x0 0x0 0x0 0x0 0x1 0x3f 0x1 0x0 0x0 0x1 0x1 0x1 0x40 0x1 0x0 0x0 0x0 0x0 0x1 0x4d 0x1 0x0 0x0 0x1 0x1 0x1 0x4e 0x1 0x0 0x0 0x1 0x1 0x1 0x4f 0x1 0x0 0x0 0x1 0x1 0x1 0x50 0x1 0x0 0x0 0x1 0x1 0x1 0x51 0x3 0x0 0x0 0x1 0x0 0x1 0x52 0x0 0x1 0x0 0x1 0x0 0x1 0x53 0x1 0x0 0x0 0x0 0x0 0x1 0x54 0x1 0x0 0x0 0x1 0x0 0x1 0x55 0x1 0x0 0x0 0x0 0x0 0x1 0x56 0x1 0x0 0x0 0x0 0x0 0x1 0x57 0x2 0x0 0x0 0x1 0x0 0x1 0x58 0x0 0x0 0x0 0x1 0x0 0x1 0x59 0x0 0x0 0x0 0x1 0x0 0x1 0x5a 0x1 0x0 0x0 0x0 0x0 0x1 0x5b 0x0 0x0 0x0 0x1 0x0 0x1 0x5c 0x0 0x1 0x0 0x1 0x0 0x1 0x5d 0x0 0x1 0x0 0x1 0x0 0x1 0x5e 0x0 0x1 0x0 0x1 0x0 0x1 0x5f 0x1 0x0 0x0 0x1 0x0 0x1 0x60 0x1 0x0 0x0 0x1 0x0 0x1 0x61 0x1 0x0 0x0 0x1 0x1 0x1 0x62 0x1 0x0 0x0 0x1 0x1 0x1 0x63 0x2 0x0 0x0 0x1 0x1 0x1 0x64 0x2 0x0 0x0 0x1 0x1 0x1 0x65 0x1 0x0 0x0 0x1 0x1 0x1 0x66 0x1 0x0 0x0 0x1 0x1 0x1 0x67 0x1 0x0 0x0 0x1 0x1 0x1 0x68 0x1 0x0 0x0 0x1 0x1 0x1 0x69 0x1 0x0 0x0 0x1 0x1 0x1 0x6a 0x1 0x0 0x0 0x1 0x1 0x1 0x6b 0x1 0x0 0x0 0x1 0x1 0x1 0x6c 0x1 0x0 0x0 0x1 0x1 0x1 0x6d 0x1 0x0 0x0 0x1 0x1 0x1 0x6e 0x1 0x0 0x0 0x1 0x1 0x1 0x6f 0x7 0x0 0x0 0x1 0x0 0x1 0x70 0x0 0x0 0x0 0x0 0x0 0x1 0x71 0x1 0x0 0x0 0x1 0x1 0x1 0x72 0x1 0x0 0x0 0x1 0x1 0x1 0x73 0x1 0x0 0x0 0x1 0x0 0x1 0x74 0x1 0x0 0x0 0x1 0x0 0x1 0x75 0x0 0x0 0x0 0x1 0x0 0x1 0x76 0x0 0x0 0x0 0x1 0x0 0x1 0x77 0x1 0x0 0x0 0x0 0x0 0x1 0x78 0x1 0x0 0x0 0x0 0x0 0x1 0x79 0x1 0x0 0x0 0x1 0x1 0x1 0x7a 0x1 0x0 0x0 0x1 0x1 0x1 0x7b 0x1 0x0 0x0 0x0 0x0 0x1 0x7c 0x1 0x0 0x0 0x0 0x0 0x1 0x7d 0x1 0x0 0x0 0x0 0x0 0x1 0x7e 0x1 0x0 0x0 0x1 0x1 0x1 0x7f 0x1 0x0 0x0 0x1 0x1 0x1 0x80 0x1 0x0 0x0 0x1 0x1 0x1 0x81 0x1 0x0 0x0 0x1 0x1 0x1 0x82 0x1 0x0 0x0 0x1 0x1 0x1 0x83 0x0 0x1 0x0 0x1 0x0 0x1 0x84 0x0 0x1 0x0 0x1 0x0 0x1 0x85 0x0 0x1 0x0 0x1 0x0 0x1 0x86 0x0 0x1 0x0 0x1 0x0 0x1 0x87 0x0 0x1 0x0 0x1 0x0 0x1 0x88 0x0 0x1 0x1 0x1 0x0 0x1 0x89 0x0 0x1 0x0 0x1 0x0 0x1 0x8a 0x0 0x1 0x0 0x1 0x0 0x1 0x8b 0x0 0x1 0x0 0x1 0x0 0x1 0x8c 0x0 0x1 0x0 0x1 0x0 0x1 0x8d 0x1 0x0 0x0 0x1 0x1 0x1 0x8e 0x1 0x0 0x0 0x1 0x1 0x1 0x8f 0x1 0x0 0x0 0x0 0x0 0x1 0x90 0x1 0x0 0x0 0x0 0x0 0x1 0x91 0x1 0x0 0x0 0x0 0x0 0x1 0x92 0x1 0x0 0x0 0x0 0x0 0x1 0x93 0x1 0x0 0x0 0x0 0x0 0x1 0x94 0x1 0x0 0x0 0x0 0x0 0x1 0x95 0x1 0x0 0x0 0x1 0x0 0x1 0x96 0x1 0x0 0x0 0x1 0x0 0x1 0x97 0x1 0x0 0x0 0x1 0x0 0x1 0x98 0x1 0x0 0x0 0x1 0x0 0x1 0x99 0x1 0x0 0x0 0x0 0x0 0x1 0x9a 0x1 0x0 0x0 0x0 0x0 0x1 0x9b 0x1 0x0 0x0 0x0 0x0 0x1 0x9c 0x1 0x0 0x0 0x0 0x0 0x1 0x9d 0x1 0x0 0x0 0x0 0x0 0x1 0x9e 0x1 0x0 0x0 0x0 0x0 0x1 0x9f 0x1 0x0 0x0 0x1 0x0 0x1 0xa0 0x1 0x0 0x0 0x1 0x0 0x1 0xa1 0x1 0x0 0x0 0x1 0x0 0x1 0xa2 0x1 0x0 0x0 0x0 0x0 0x0 0xa3 0x1 0x0 0x0 0x1 0x0 0x0 0xa4 0x1 0x0 0x0 0x1 0x0 0x1 0xa5 0x1 0x0 0x0 0x1 0x0 0x1 0xa6 0x1 0x0 0x0 0x0 0x0 0x1 0xa7 0x1 0x0 0x0 0x0 0x0 0x1 0xa8 0x1 0x0 0x0 0x0 0x0 0x1 0xa9 0x1 0x0 0x0 0x0 0x0 0x1 0xaa 0x1 0x0 0x0 0x0 0x0 0x1 0xab 0x0 0x1 0x1 0x1 0x0 0x1 0xac 0x1 0x0 0x0 0x0 0x0 0x1 0xad 0x1 0x0 0x0 0x0 0x0 0x1 0xae 0x1 0x0 0x0 0x0 0x0 0x1 0xaf 0x1 0x0 0x0 0x0 0x0 0x1 0xb0 0x1 0x0 0x0 0x0 0x0 0x1 0xb1 0x1 0x0 0x0 0x0 0x0 0x1 0xb2 0x1 0x0 0x0 0x0 0x0 0x1 0xb3 0x1 0x0 0x0 0x0 0x0 0x1 0xb4 0x1 0x0 0x0 0x0 0x0 0x1 0xb5 0x1 0x0 0x0 0x0 0x0 0x1 0xb6 0x0 0x1 0x0 0x1 0x0 0x1 0xb7 0x1 0x0 0x0 0x0 0x0 0x1 0xb8 0x1 0x0 0x0 0x0 0x0 0x1 0xb9 0x0 0x1 0x0 0x1 0x0 0x1 0xba 0x0 0x1 0x0 0x1 0x0 0x1 0xbb 0x1 0x0 0x0 0x0 0x0 0x1 0xbc 0x1 0x0 0x0 0x0 0x0 0x0 0xbd 0x1 0x0 0x0 0x1 0x0 0x0 0xbe 0x1 0x0 0x0 0x0 0x0 0x0 0xbf 0x1 0x0 0x0 0x1 0x0 0x0 0xc0 0x0 0x0 0x0 0x1 0x0 0x1 0xc1 0x0 0x0 0x0 0x1 0x0 0x1 0xc2 0x0 0x0 0x0 0x1 0x0 0x1 0xc3 0x0 0x0 0x0 0x1 0x0 0x1 0xc4 0x0 0x0 0x0 0x1 0x0 0x1 0xc5 0x0 0x0 0x0 0x1 0x0 0x1 0xc6 0x0 0x0 0x0 0x1 0x0 0x1 0xc7 0x0 0x0 0x0 0x1 0x0 0x1 0xc8 0x0 0x0 0x0 0x1 0x0 0x1>;
		};
	};

	fragment@48 {
		target = <0xffffffff>;

		__overlay__ {
			deb-gpios = <0xffffffff 0x1 0x0>;
			debounce = <0x7d000>;
			interrupt-parent = <0xffffffff>;
			interrupts = <0x1 0x8>;
			status = "okay";
		};
	};

	fragment@49 {
		target = <0xffffffff>;

		__overlay__ {
			interrupt-parent = <0xffffffff>;
			interrupts = <0xa 0x2>;
			status = "okay";
		};
	};

	fragment@5 {
		target = <0xffffffff>;

		__overlay__ {
			ACTIVE_TABLE = <0x5>;
			KEEP_100_PERCENT = <0x2>;
			battery0_profile_t0 = <0x0 0xa9d8 0x370 0x202 0xa924 0x36c 0x403 0xa87f 0x359 0x605 0xa7ed 0x360 0x807 0xa764 0x360 0xa08 0xa6e1 0x359 0xc0a 0xa669 0x36e 0xe0b 0xa5f1 0x384 0x100d 0xa571 0x36f 0x120f 0xa4fe 0x36b 0x1410 0xa48a 0x36b 0x1612 0xa416 0x375 0x1814 0xa3a4 0x37d 0x1a15 0xa32d 0x36e 0x1c17 0xa2be 0x384 0x1e19 0xa24f 0x384 0x201a 0xa1df 0x384 0x221c 0xa170 0x384 0x241d 0xa100 0x384 0x261f 0xa08f 0x384 0x2821 0xa021 0x384 0x2a22 0x9fbb 0x384 0x2c24 0x9f54 0x399 0x2e26 0x9eed 0x39d 0x3027 0x9e87 0x38f 0x3229 0x9e31 0x3a3 0x342b 0x9ddc 0x3c1 0x362c 0x9d61 0x39d 0x382e 0x9cd8 0x39d 0x3a2f 0x9c71 0x3b2 0x3c31 0x9c34 0x3c7 0x3e33 0x9bf0 0x3c1 0x4034 0x9b9f 0x3b6 0x4236 0x9b4c 0x3bd 0x4438 0x9aff 0x3cf 0x4639 0x9ab2 0x3cf 0x483b 0x9a65 0x3e4 0x4a3d 0x9a18 0x3f9 0x4c3e 0x99cb 0x401 0x4e40 0x997e 0x415 0x5041 0x9933 0x440 0x5243 0x98ea 0x462 0x5445 0x9883 0x44d 0x5646 0x97fc 0x3f9 0x5848 0x977a 0x3b5 0x5a4a 0x970f 0x382 0x5c4b 0x96bc 0x36b 0x5e4d 0x967a 0x36b 0x604f 0x963e 0x36b 0x6250 0x9603 0x36b 0x6452 0x95cf 0x357 0x6653 0x95a2 0x363 0x6855 0x9577 0x378 0x6a57 0x9548 0x37a 0x6c58 0x951a 0x372 0x6e5a 0x94f6 0x381 0x705c 0x94cb 0x36c 0x725d 0x94a9 0x380 0x745f 0x9487 0x384 0x7661 0x9464 0x384 0x7862 0x9442 0x384 0x7a64 0x9422 0x38a 0x7c65 0x9409 0x3a0 0x7e67 0x93ef 0x3b5 0x8069 0x93d5 0x3b6 0x826a 0x93bc 0x3b6 0x846c 0x93a2 0x3c3 0x866e 0x9388 0x3cf 0x886f 0x936c 0x3cf 0x8a71 0x9345 0x3c7 0x8c73 0x92f8 0x387 0x8e74 0x92ab 0x370 0x9076 0x9279 0x37c 0x9277 0x924e 0x384 0x9479 0x9227 0x384 0x967b 0x9202 0x384 0x987c 0x91d7 0x384 0x9a7e 0x91ad 0x384 0x9c80 0x918a 0x384 0x9e81 0x9168 0x395 0xa083 0x913b 0x39d 0xa285 0x9104 0x39d 0xa486 0x90c8 0x39d 0xa688 0x908b 0x39d 0xa889 0x9047 0x39d 0xaa8b 0x8ff2 0x389 0xac8d 0x8fb7 0x374 0xae8e 0x8fa2 0x378 0xb090 0x8f9e 0x397 0xb292 0x8f93 0x3bc 0xb493 0x8f81 0x3d6 0xb695 0x8f67 0x416 0xb897 0x8efd 0x406 0xba98 0x8db9 0x3e0 0xbc9a 0x8bd5 0x3f6 0xbe9b 0x893d 0x436 0xc09d 0x8560 0x4a5 0xc29f 0x7ebe 0x8d3 0xc4a0 0x729c 0xd16 0xc6a2 0x729c 0xd16>;
			battery0_profile_t0_col = <0x3>;
			battery0_profile_t0_num = <0x64>;
			battery0_profile_t1 = <0x0 0xaa32 0x4b0 0x202 0xa976 0x4b0 0x403 0xa8cf 0x4b0 0x605 0xa837 0x4b0 0x807 0xa7ae 0x4b0 0xa08 0xa731 0x4b0 0xc0a 0xa6b9 0x4b0 0xe0b 0xa641 0x4b0 0x100d 0xa5c9 0x4b0 0x120f 0xa551 0x49e 0x1410 0xa4da 0x497 0x1612 0xa466 0x497 0x1814 0xa3f7 0x497 0x1a15 0xa387 0x49a 0x1c17 0xa318 0x4b0 0x1e19 0xa2a9 0x4b0 0x201a 0xa240 0x4c1 0x221c 0xa1cf 0x4bb 0x241d 0xa15a 0x4ba 0x261f 0xa0e9 0x4c9 0x2821 0xa07b 0x4cc 0x2a22 0xa015 0x4e2 0x2c24 0x9fae 0x4e2 0x2e26 0x9f5c 0x505 0x3027 0x9f26 0x53e 0x3229 0x9eef 0x574 0x342b 0x9e8f 0x57c 0x362c 0x9ded 0x53f 0x382e 0x9d1f 0x515 0x3a2f 0x9c74 0x4ff 0x3c31 0x9bf2 0x4fb 0x3e33 0x9b91 0x509 0x4034 0x9b47 0x51e 0x4236 0x9b11 0x541 0x4438 0x9ae8 0x57e 0x4639 0x9acf 0x5a9 0x483b 0x9a9c 0x5aa 0x4a3d 0x9a54 0x599 0x4c3e 0x9a0c 0x5ac 0x4e40 0x99c4 0x5cd 0x5041 0x9974 0x5d6 0x5243 0x991d 0x5c0 0x5445 0x98bf 0x5ab 0x5646 0x9850 0x56c 0x5848 0x97d4 0x51b 0x5a4a 0x9763 0x4d3 0x5c4b 0x9704 0x49c 0x5e4d 0x96b6 0x47e 0x604f 0x9679 0x47b 0x6250 0x9635 0x466 0x6452 0x9601 0x465 0x6653 0x95d4 0x476 0x6855 0x95a4 0x471 0x6a57 0x9574 0x465 0x6c58 0x9549 0x465 0x6e5a 0x951f 0x468 0x705c 0x94fd 0x47d 0x725d 0x94d3 0x469 0x745f 0x94b5 0x487 0x7661 0x9496 0x497 0x7862 0x9474 0x497 0x7a64 0x9454 0x497 0x7c65 0x943b 0x49a 0x7e67 0x9421 0x4af 0x8069 0x93ff 0x49b 0x826a 0x93ea 0x4a8 0x846c 0x93d4 0x4b0 0x866e 0x93be 0x4ba 0x886f 0x93ab 0x4c3 0x8a71 0x9391 0x4b0 0x8c73 0x9377 0x4b0 0x8e74 0x935e 0x49c 0x9076 0x933d 0x486 0x9277 0x9320 0x47e 0x9479 0x92ff 0x474 0x967b 0x92d4 0x45f 0x987c 0x92aa 0x44e 0x9a7e 0x9288 0x464 0x9c80 0x9266 0x465 0x9e81 0x9244 0x476 0xa083 0x921c 0x47e 0xa285 0x91ee 0x487 0xa486 0x91b6 0x497 0xa688 0x9172 0x497 0xa889 0x9136 0x497 0xaa8b 0x90fa 0x4ab 0xac8d 0x90a4 0x4b0 0xae8e 0x9064 0x4bd 0xb090 0x9045 0x4c9 0xb292 0x9033 0x4cf 0xb493 0x9023 0x4e9 0xb695 0x901a 0x529 0xb897 0x8ffa 0x541 0xba98 0x8fb0 0x588 0xbc9a 0x8eaf 0x59d 0xbe9b 0x8ce8 0x5c0 0xc09d 0x8a6d 0x63c 0xc29f 0x86f1 0x706 0xc4a0 0x810f 0x8dd 0xc6a2 0x73aa 0x10cc>;
			battery0_profile_t1_col = <0x3>;
			battery0_profile_t1_num = <0x64>;
			battery0_profile_t2 = <0x0 0xaa28 0x9b0 0x202 0xa963 0x9ac 0x403 0xa8bb 0x9bd 0x605 0xa823 0x9c4 0x807 0xa79a 0x9b9 0xa08 0xa71d 0x9b2 0xc0a 0xa6a5 0x9c1 0xe0b 0xa62d 0x9ab 0x100d 0xa5be 0x996 0x120f 0xa547 0x992 0x1410 0xa4d5 0x984 0x1612 0xa466 0x979 0x1814 0xa3f7 0x979 0x1a15 0xa389 0x97c 0x1c17 0xa322 0x992 0x1e19 0xa2b3 0x992 0x201a 0xa243 0x992 0x221c 0xa1d4 0x9a0 0x241d 0xa168 0x9b5 0x261f 0xa0fd 0x9bd 0x2821 0xa08e 0x9a8 0x2a22 0xa01f 0x992 0x2c24 0x9fd2 0x9bd 0x2e26 0x9f8c 0xa2e 0x3027 0x9f52 0xaae 0x3229 0x9f0a 0xafa 0x342b 0x9e93 0xae7 0x362c 0x9de1 0xa75 0x382e 0x9d0b 0x9df 0x3a2f 0x9c57 0x99e 0x3c31 0x9bd4 0x992 0x3e33 0x9b6d 0x992 0x4034 0x9b17 0x992 0x4236 0x9ad2 0x9a6 0x4438 0x9a9f 0x9e3 0x4639 0x9a6b 0xa0e 0x483b 0x9a40 0xa39 0x4a3d 0x9a08 0xa30 0x4c3e 0x99c6 0xa1a 0x4e40 0x997a 0x9fb 0x5041 0x991f 0x9c3 0x5243 0x98b8 0x96d 0x5445 0x9851 0x918 0x5646 0x97eb 0x8d7 0x5848 0x9784 0x886 0x5a4a 0x972d 0x859 0x5c4b 0x96e0 0x843 0x5e4d 0x9698 0x834 0x604f 0x965c 0x834 0x6250 0x9621 0x834 0x6452 0x95ed 0x820 0x6653 0x95b9 0x81b 0x6855 0x958b 0x828 0x6a57 0x9560 0x834 0x6c58 0x9535 0x834 0x6e5a 0x950a 0x834 0x705c 0x94df 0x834 0x725d 0x94bd 0x834 0x745f 0x949b 0x834 0x7661 0x947e 0x842 0x7862 0x9460 0x84d 0x7a64 0x943e 0x847 0x7c65 0x941d 0x837 0x7e67 0x9403 0x84c 0x8069 0x93e9 0x84d 0x826a 0x93d6 0x85e 0x846c 0x93c5 0x866 0x866e 0x93b4 0x870 0x886f 0x93a6 0x891 0x8a71 0x939c 0x8cd 0x8c73 0x938b 0x8e2 0x8e74 0x937a 0x920 0x9076 0x9369 0x960 0x9277 0x9352 0x993 0x9479 0x9335 0x9be 0x967b 0x9312 0x9f5 0x987c 0x92f0 0xa4a 0x9a7e 0x92ce 0xaa0 0x9c80 0x92ac 0xaf6 0x9e81 0x9283 0xb4b 0xa083 0x9253 0xba1 0xa285 0x9218 0xbed 0xa486 0x91d6 0xc3f 0xa688 0x919a 0xcbd 0xa889 0x915e 0xd28 0xaa8b 0x9112 0xda7 0xac8d 0x90c5 0xe27 0xae8e 0x908c 0xec1 0xb090 0x9069 0xf80 0xb292 0x904f 0x1053 0xb493 0x9035 0x1124 0xb695 0x901b 0x127b 0xb897 0x8fea 0x13e5 0xba98 0x8f67 0x1540 0xbc9a 0x8e50 0x1656 0xbe9b 0x8c77 0x179f 0xc09d 0x89b5 0x19c9 0xc29f 0x8597 0x1de7 0xc4a0 0x7df4 0x2985 0xc6a2 0x742c 0x122a>;
			battery0_profile_t2_col = <0x3>;
			battery0_profile_t2_num = <0x64>;
			battery0_profile_t3 = <0x0 0xaabe 0x13ec 0x202 0xa9bd 0x13ec 0x403 0xa8f5 0x1410 0x605 0xa844 0x1410 0x807 0xa7a6 0x13fa 0xa08 0xa717 0x13de 0xc0a 0xa691 0x13b7 0xe0b 0xa619 0x13a1 0x100d 0xa5a1 0x138c 0x120f 0xa529 0x1376 0x1410 0xa4b7 0x1361 0x1612 0xa444 0x1341 0x1814 0xa3d1 0x1324 0x1a15 0xa369 0x1321 0x1c17 0xa2fa 0x130b 0x1e19 0xa28b 0x12f6 0x201a 0xa222 0x12f2 0x221c 0xa1b6 0x12e4 0x241d 0xa146 0x12cf 0x261f 0xa0d5 0x12b9 0x2821 0xa06c 0x12b5 0x2a22 0xa01f 0x130a 0x2c24 0x9fda 0x138b 0x2e26 0x9f8e 0x13d6 0x3027 0x9f3c 0x13ec 0x3229 0x9ecd 0x13c2 0x342b 0x9e34 0x1336 0x362c 0x9d76 0x1242 0x382e 0x9cb1 0x1197 0x3a2f 0x9c16 0x1116 0x3c31 0x9b98 0x10ca 0x3e33 0x9b31 0x10b3 0x4034 0x9adb 0x10a9 0x4236 0x9a91 0x109a 0x4438 0x9a4b 0x1097 0x4639 0x99fe 0x1082 0x483b 0x99b9 0x1057 0x4a3d 0x9975 0x102c 0x4c3e 0x992b 0x1002 0x4e40 0x98de 0xfcd 0x5041 0x9891 0xf8d 0x5243 0x9842 0xf4c 0x5445 0x97ed 0xf0c 0x5646 0x9797 0xeb7 0x5848 0x9749 0xe84 0x5a4a 0x9701 0xe59 0x5c4b 0x96bc 0xe42 0x5e4d 0x9678 0xe2f 0x604f 0x9636 0xdf7 0x6250 0x9602 0xdf7 0x6452 0x95cf 0xdf7 0x6653 0x959b 0xde6 0x6855 0x956d 0xdde 0x6a57 0x953e 0xdd4 0x6c58 0x9510 0xdd2 0x6e5a 0x94ec 0xdf4 0x705c 0x94c1 0xddf 0x725d 0x949f 0xdf3 0x745f 0x947d 0xe08 0x7661 0x945a 0xe10 0x7862 0x9438 0xe10 0x7a64 0x941b 0xe23 0x7c65 0x940a 0xe60 0x7e67 0x93f9 0xe8b 0x8069 0x93f0 0xf08 0x826a 0x93e0 0xf89 0x846c 0x93cf 0xffc 0x866e 0x93c2 0x1084 0x886f 0x93b7 0x1129 0x8a71 0x93a6 0x11bc 0x8c73 0x9395 0x123d 0x8e74 0x9384 0x12d1 0x9076 0x9373 0x1389 0x9277 0x935c 0x143c 0x9479 0x9343 0x14e7 0x967b 0x9329 0x159e 0x987c 0x930e 0x1669 0x9a7e 0x92ec 0x16d4 0x9c80 0x92ca 0x17a4 0x9e81 0x92a1 0x1858 0xa083 0x9271 0x1904 0xa285 0x923e 0x19c2 0xa486 0x9208 0x1a8c 0xa688 0x91cb 0x1b3c 0xa889 0x9187 0x1c12 0xaa8b 0x9142 0x1ce8 0xac8d 0x910b 0x1dff 0xae8e 0x90d7 0x1f37 0xb090 0x90a7 0x20a0 0xb292 0x907c 0x2236 0xb493 0x9052 0x23c8 0xb695 0x9030 0x25df 0xb897 0x8fed 0x280a 0xba98 0x8f7a 0x2a9a 0xbc9a 0x8eb1 0x2d2d 0xbe9b 0x8d6e 0x2fb8 0xc09d 0x8b83 0x3278 0xc29f 0x88a9 0x35c2 0xc4a0 0x841b 0x38d8 0xc6a2 0x7918 0x1d7e>;
			battery0_profile_t3_col = <0x3>;
			battery0_profile_t3_num = <0x64>;
			battery0_profile_t4 = <0x0 0xaa64 0x2634 0x202 0xa938 0x2630 0x403 0xa846 0x261d 0x605 0xa781 0x25fa 0x807 0xa6d1 0x258f 0xa08 0xa62e 0x2507 0xc0a 0xa59d 0x24bd 0xe0b 0xa50b 0x243c 0x100d 0xa48b 0x23fb 0x120f 0xa411 0x23de 0x1410 0xa39a 0x23ad 0x1612 0xa326 0x2377 0x1814 0xa2b4 0x2338 0x1a15 0xa23d 0x22cd 0x1c17 0xa1ce 0x2262 0x1e19 0xa15f 0x220c 0x201a 0xa0fd 0x21d9 0x221c 0xa0aa 0x21bc 0x241d 0xa05d 0x21c6 0x261f 0xa009 0x21dc 0x2821 0x9fa9 0x21c0 0x2a22 0x9f43 0x217f 0x2c24 0x9eb2 0x20ab 0x2e26 0x9e0b 0x1fb1 0x3027 0x9d60 0x1ecc 0x3229 0x9cbd 0x1dec 0x342b 0x9c2e 0x1d23 0x362c 0x9bb7 0x1ca2 0x382e 0x9b48 0x1c22 0x3a2f 0x9ae9 0x1bcc 0x3c31 0x9a92 0x1b88 0x3e33 0x9a48 0x1b47 0x4034 0x99ff 0x1b1c 0x4236 0x99b2 0x1af9 0x4438 0x9965 0x1abc 0x4639 0x9918 0x1a91 0x483b 0x98cb 0x1a66 0x4a3d 0x9885 0x1a3b 0x4c3e 0x983b 0x1a03 0x4e40 0x97ee 0x19cd 0x5041 0x97a1 0x19af 0x5243 0x9755 0x19a6 0x5445 0x9710 0x1966 0x5646 0x96cc 0x1964 0x5848 0x968e 0x1964 0x5a4a 0x9652 0x1964 0x5c4b 0x9616 0x1964 0x5e4d 0x95da 0x1957 0x604f 0x95a1 0x1937 0x6250 0x9576 0x1962 0x6452 0x9543 0x1964 0x6653 0x950f 0x1964 0x6855 0x94e1 0x1971 0x6a57 0x94ba 0x1991 0x6c58 0x949a 0x19c9 0x6e5a 0x9481 0x1a22 0x705c 0x9467 0x1a8d 0x725d 0x9455 0x1b0c 0x745f 0x9444 0x1b9e 0x7661 0x9433 0x1c4f 0x7862 0x9426 0x1d0f 0x7a64 0x941b 0x1dca 0x7c65 0x940a 0x1e75 0x7e67 0x93f9 0x1f20 0x8069 0x93f0 0x2009 0x826a 0x93e0 0x20e3 0x846c 0x93cf 0x21b9 0x866e 0x93be 0x228f 0x886f 0x93ad 0x2365 0x8a71 0x939c 0x243e 0x8c73 0x938b 0x2529 0x8e74 0x9372 0x2615 0x9076 0x935f 0x2711 0x9277 0x9348 0x27f7 0x9479 0x932f 0x28cd 0x967b 0x9315 0x29a3 0x987c 0x92fa 0x2a79 0x9a7e 0x92d8 0x2b50 0x9c80 0x92b6 0x2c3a 0x9e81 0x928d 0x2d15 0xa083 0x925d 0x2dde 0xa285 0x922a 0x2ea8 0xa486 0x91f6 0x2f78 0xa688 0x91c2 0x303d 0xa889 0x9186 0x3128 0xaa8b 0x914a 0x3200 0xac8d 0x910e 0x32f6 0xae8e 0x90d7 0x3404 0xb090 0x90ab 0x3526 0xb292 0x9088 0x3661 0xb493 0x9066 0x37bc 0xb695 0x9044 0x393d 0xb897 0x9009 0x3ad3 0xba98 0x8fa6 0x3c9b 0xbc9a 0x8eba 0x3e3e 0xbe9b 0x8d08 0x401d 0xc09d 0x8a76 0x4241 0xc29f 0x869d 0x3f19 0xc4a0 0x7f57 0x2d49 0xc6a2 0x7bc0 0x249f>;
			battery0_profile_t4_col = <0x3>;
			battery0_profile_t4_num = <0x64>;
			battery1_profile_t0 = <0x0 0xaa32 0x370 0x206 0xa9b0 0x36c 0x40c 0xa936 0x36b 0x613 0xa8bd 0x37a 0x819 0xa844 0x384 0xa1f 0xa7cb 0x384 0xc25 0xa750 0x384 0xe2b 0xa6d7 0x384 0x1031 0xa65e 0x384 0x1238 0xa5e5 0x384 0x143e 0xa56d 0x384 0x1644 0xa4f4 0x384 0x184a 0xa47b 0x384 0x1a50 0xa404 0x38a 0x1c57 0xa393 0x39d 0x1e5d 0xa31a 0x39d 0x2063 0xa29f 0x388 0x2269 0xa22d 0x396 0x246f 0xa1bd 0x39d 0x2675 0xa14c 0x39d 0x287c 0xa0dc 0x39d 0x2a82 0xa06c 0x39d 0x2c88 0x9ffc 0x39d 0x2e8e 0x9f94 0x39d 0x3094 0x9f2d 0x3b0 0x329b 0x9ec5 0x3b6 0x34a1 0x9e5c 0x3aa 0x36a7 0x9df8 0x3a6 0x38ad 0x9d99 0x3bc 0x3ab3 0x9d3a 0x3cf 0x3cb9 0x9cdb 0x3cf 0x3ec0 0x9c7c 0x3cf 0x40c6 0x9c23 0x3e0 0x42cc 0x9bcd 0x3e8 0x44d2 0x9b77 0x3f2 0x46d8 0x9b20 0x401 0x48df 0x9acb 0x408 0x4ae5 0x9a7d 0x433 0x4ceb 0x9a1d 0x449 0x4ef1 0x99af 0x44c 0x50f7 0x9926 0x40f 0x52fd 0x989d 0x3c4 0x5504 0x9829 0x39d 0x570a 0x97ce 0x39d 0x5910 0x9781 0x39d 0x5b16 0x973c 0x39d 0x5d1c 0x96fe 0x39d 0x5f23 0x96c2 0x38d 0x6129 0x9685 0x384 0x632f 0x964c 0x384 0x6535 0x9618 0x384 0x673b 0x95e6 0x384 0x6941 0x95ba 0x384 0x6b48 0x9587 0x384 0x6d4e 0x955a 0x384 0x6f54 0x952f 0x384 0x715a 0x9508 0x38f 0x7360 0x94e6 0x39d 0x7567 0x94c3 0x39d 0x776d 0x94a0 0x39e 0x7973 0x947d 0x3b4 0x7b79 0x945b 0x3b6 0x7d7f 0x9438 0x3b6 0x7f85 0x941b 0x3c3 0x818c 0x9401 0x3d8 0x8392 0x93e5 0x3e8 0x8598 0x93c0 0x3e6 0x879e 0x938c 0x3d0 0x89a4 0x9340 0x391 0x8bab 0x92f8 0x396 0x8db1 0x92be 0x39d 0x8fb7 0x928e 0x39d 0x91bd 0x9263 0x3a4 0x93c3 0x9236 0x3ae 0x95c9 0x9203 0x384 0x97d0 0x91d8 0x384 0x99d6 0x91bb 0x3aa 0x9bdc 0x9195 0x3b6 0x9de2 0x916a 0x3b6 0x9fe8 0x9138 0x3b6 0xa1ef 0x90f8 0x3b0 0xa3f5 0x90b5 0x39f 0xa5fb 0x9081 0x3b5 0xa801 0x903d 0x3b6 0xaa07 0x8ff1 0x394 0xac0d 0x8fc4 0x384 0xae14 0x8fb2 0x38e 0xb01a 0x8fa9 0x3aa 0xb220 0x8f9f 0x3d9 0xb426 0x8f8e 0x41a 0xb62c 0x8f6b 0x45c 0xb833 0x8eca 0x41b 0xba39 0x8d72 0x401 0xbc3f 0x8b7f 0x418 0xbe45 0x88e1 0x454 0xc04b 0x851e 0x4f4 0xc251 0x7f2e 0x900 0xc458 0x730a 0xef1 0xc65e 0x730a 0xef1 0xc864 0x730a 0xef1>;
			battery1_profile_t0_col = <0x3>;
			battery1_profile_t0_num = <0x64>;
			battery1_profile_t1 = <0x0 0xaa6e 0x4ce 0x206 0xa9f5 0x4ca 0x40c 0xa983 0x4db 0x613 0xa90d 0x4e2 0x819 0xa894 0x4d7 0xa1f 0xa81b 0x4c9 0xc25 0xa7a0 0x4c9 0xe2b 0xa727 0x4c9 0x1031 0xa6ae 0x4c9 0x1238 0xa635 0x4c9 0x143e 0xa5bd 0x4c9 0x1644 0xa544 0x4bc 0x184a 0xa4cb 0x4b0 0x1a50 0xa452 0x4b0 0x1c57 0xa3da 0x4b3 0x1e5d 0xa36a 0x4c8 0x2063 0xa2f8 0x4c9 0x2269 0xa280 0x4c9 0x246f 0xa20d 0x4c9 0x2675 0xa19c 0x4c9 0x287c 0xa12c 0x4c9 0x2a82 0xa0bc 0x4c9 0x2c88 0xa04c 0x4ca 0x2e8e 0x9fe4 0x4df 0x3094 0x9f7d 0x4e2 0x329b 0x9f15 0x4e2 0x34a1 0x9eac 0x4e2 0x36a7 0x9e48 0x4f4 0x38ad 0x9de6 0x514 0x3ab3 0x9d7f 0x514 0x3cb9 0x9d17 0x514 0x3ec0 0x9cc0 0x53d 0x40c6 0x9c63 0x546 0x42cc 0x9c09 0x546 0x44d2 0x9bb7 0x565 0x46d8 0x9b66 0x591 0x48df 0x9b10 0x598 0x4ae5 0x9ab9 0x5c3 0x4ceb 0x9a59 0x5c3 0x4ef1 0x99e3 0x5b0 0x50f7 0x995e 0x55d 0x52fd 0x98d4 0x4fd 0x5504 0x9857 0x4b8 0x570a 0x97f4 0x492 0x5910 0x979f 0x47e 0x5b16 0x975a 0x47e 0x5d1c 0x971c 0x492 0x5f23 0x96d9 0x487 0x6129 0x969e 0x47e 0x632f 0x966a 0x47e 0x6535 0x9636 0x47e 0x673b 0x9602 0x47e 0x6941 0x95ce 0x47e 0x6b48 0x95a3 0x47e 0x6d4e 0x9578 0x47e 0x6f54 0x9553 0x48d 0x715a 0x952c 0x497 0x7360 0x9504 0x497 0x7567 0x94e1 0x49b 0x776d 0x94be 0x4b0 0x7973 0x949b 0x4b0 0x7b79 0x9481 0x4c4 0x7d7f 0x9460 0x4c9 0x7f85 0x9443 0x4d6 0x818c 0x9429 0x4eb 0x8392 0x940d 0x4f5 0x8598 0x93eb 0x4e5 0x879e 0x93d1 0x4fa 0x89a4 0x93af 0x4e6 0x8bab 0x9385 0x4d1 0x8db1 0x9360 0x4bb 0x8fb7 0x9339 0x4a5 0x91bd 0x9310 0x49e 0x93c3 0x92ec 0x4b0 0x95c9 0x92c1 0x4b0 0x97d0 0x9296 0x4b0 0x99d6 0x9272 0x4b0 0x9bdc 0x924f 0x4b0 0x9de2 0x9228 0x4bc 0x9fe8 0x91f9 0x4c9 0xa1ef 0x91c1 0x4c9 0xa3f5 0x917e 0x4cb 0xa5fb 0x9149 0x4e1 0xa801 0x910d 0x4f6 0xaa07 0x90bc 0x4fb 0xac0d 0x9076 0x509 0xae14 0x904e 0x51e 0xb01a 0x903f 0x53a 0xb220 0x9035 0x566 0xb426 0x9024 0x591 0xb62c 0x900a 0x5bc 0xb833 0x8fdb 0x60b 0xba39 0x8f1d 0x627 0xbc3f 0x8da7 0x656 0xbe45 0x8b83 0x6bd 0xc04b 0x8899 0x761 0xc251 0x844a 0x9e2 0xc458 0x7b85 0x1f8f 0xc65e 0x7738 0x194b 0xc864 0x7738 0x194b>;
			battery1_profile_t1_col = <0x3>;
			battery1_profile_t1_num = <0x64>;
			battery1_profile_t2 = <0x0 0xaaf0 0xa14 0x206 0xaaab 0xa10 0x40c 0xaa33 0xa6a 0x613 0xa9b7 0xa8c 0x819 0xa943 0xa75 0xa1f 0xa8cf 0xa4a 0xc25 0xa854 0xa23 0xe2b 0xa7db 0xa0c 0x1031 0xa762 0x9e1 0x1238 0xa6e9 0x9b6 0x143e 0xa671 0x97a 0x1644 0xa5f8 0x953 0x184a 0xa57f 0x934 0x1a50 0xa506 0x90f 0x1c57 0xa48e 0x8f9 0x1e5d 0xa41e 0x8e4 0x2063 0xa3a3 0x8b9 0x2269 0xa331 0x89f 0x246f 0xa2bb 0x88a 0x2675 0xa246 0x87f 0x287c 0xa1d6 0x87f 0x2a82 0xa166 0x87f 0x2c88 0xa0f6 0x880 0x2e8e 0xa08e 0x895 0x3094 0xa01f 0x898 0x329b 0x9fb5 0x898 0x34a1 0x9f4c 0x898 0x36a7 0x9ee8 0x8a1 0x38ad 0x9e86 0x8b1 0x3ab3 0x9e1e 0x8af 0x3cb9 0x9dad 0x899 0x3ec0 0x9d3d 0x898 0x40c6 0x9ccd 0x887 0x42cc 0x9c6d 0x88d 0x44d2 0x9c17 0x898 0x46d8 0x9bc0 0x898 0x48df 0x9b6a 0x89c 0x4ae5 0x9b13 0x8b1 0x4ceb 0x9ab3 0x89b 0x4ef1 0x9a4c 0x873 0x50f7 0x99de 0x847 0x52fd 0x9969 0x810 0x5504 0x98f4 0x7d0 0x570a 0x9886 0x794 0x5910 0x981f 0x769 0x5b16 0x97c0 0x73d 0x5d1c 0x9771 0x73a 0x5f23 0x9729 0x72a 0x6129 0x96e9 0x721 0x632f 0x96ac 0x721 0x6535 0x966f 0x721 0x673b 0x9634 0x721 0x6941 0x9600 0x721 0x6b48 0x95d5 0x736 0x6d4e 0x95a3 0x73a 0x6f54 0x9575 0x749 0x715a 0x954a 0x753 0x7360 0x9522 0x75b 0x7567 0x94fd 0x76c 0x776d 0x94d2 0x76c 0x7973 0x94af 0x76c 0x7b79 0x948d 0x780 0x7d7f 0x946a 0x795 0x7f85 0x944d 0x79e 0x818c 0x9433 0x7a7 0x8392 0x9417 0x7b7 0x8598 0x93f5 0x7b7 0x879e 0x93db 0x7b7 0x89a4 0x93c9 0x7e0 0x8bab 0x93b1 0x7d7 0x8db1 0x939d 0x7de 0x8fb7 0x938b 0x7f4 0x91bd 0x9377 0x809 0x93c3 0x935d 0x81f 0x95c9 0x9343 0x834 0x97d0 0x9318 0x834 0x99d6 0x92ec 0x847 0x9bdc 0x92c7 0x86c 0x9de2 0x92a5 0x8a3 0x9fe8 0x927f 0x8db 0xa1ef 0x9251 0x90d 0xa3f5 0x921b 0x94b 0xa5fb 0x91d6 0x977 0xa801 0x9199 0x9cb 0xaa07 0x915c 0xa32 0xac0d 0x9115 0xa90 0xae14 0x90c3 0xaf1 0xb01a 0x9078 0xb63 0xb220 0x9049 0xbf2 0xb426 0x9038 0xcca 0xb62c 0x901e 0xda6 0xb833 0x9004 0xedb 0xba39 0x8fe4 0x105b 0xbc3f 0x8f97 0x123c 0xbe45 0x8eca 0x1479 0xc04b 0x8d35 0x1748 0xc251 0x8ae1 0x1b8f 0xc458 0x87a4 0x22fb 0xc65e 0x827e 0x30b7 0xc864 0x779c 0x1aa9>;
			battery1_profile_t2_col = <0x3>;
			battery1_profile_t2_num = <0x64>;
			battery1_profile_t3 = <0x0 0xaa96 0x546 0x206 0xaa26 0x546 0x40c 0xa9d3 0x58f 0x613 0xa94a 0xe9c 0x819 0xa8af 0x14cd 0xa1f 0xa821 0x14a5 0xc25 0xa79c 0x1446 0xe2b 0xa713 0x1419 0x1031 0xa691 0x13d9 0x1238 0xa617 0x1398 0x143e 0xa598 0x1347 0x1644 0xa51c 0x12fd 0x184a 0xa4a3 0x12bc 0x1a50 0xa42a 0x1288 0x1c57 0xa3b2 0x126d 0x1e5d 0xa342 0x122c 0x2063 0xa2c7 0x11ea 0x2269 0xa255 0x11bb 0x246f 0xa1e5 0x1190 0x2675 0xa174 0x1144 0x287c 0xa107 0x1106 0x2a82 0xa09e 0x110f 0x2c88 0xa02e 0x10e3 0x2e8e 0x9fc6 0x10a2 0x3094 0x9f66 0x1087 0x329b 0x9f07 0x1081 0x34a1 0x9ea2 0x1075 0x36a7 0x9e32 0x1056 0x38ad 0x9db7 0x1025 0x3ab3 0x9d37 0xfe6 0x3cb9 0x9cbe 0xfbb 0x3ec0 0x9c4d 0xf7b 0x40c6 0x9beb 0xf5d 0x42cc 0x9b91 0xf55 0x44d2 0x9b3b 0xf40 0x46d8 0x9ae2 0xf0e 0x48df 0x9a81 0xed1 0x4ae5 0x9a19 0xea6 0x4ceb 0x99b0 0xe64 0x4ef1 0x9941 0xe10 0x50f7 0x98d7 0xdd8 0x52fd 0x9874 0xda1 0x5504 0x9815 0xd69 0x570a 0x97ba 0xd48 0x5910 0x976d 0xd48 0x5b16 0x9728 0xd48 0x5d1c 0x96db 0xd20 0x5f23 0x969a 0xd26 0x6129 0x9662 0xd3c 0x632f 0x962a 0xd3e 0x6535 0x95f0 0xd36 0x673b 0x95be 0xd4e 0x6941 0x9592 0xd7a 0x6b48 0x955f 0xd7a 0x6d4e 0x9532 0xd9e 0x6f54 0x9507 0xdbb 0x715a 0x94e0 0xddb 0x7360 0x94be 0xe07 0x7567 0x9499 0xe29 0x776d 0x946e 0xe2d 0x7973 0x9454 0xe6e 0x7b79 0x9433 0xe88 0x7d7f 0x9417 0xead 0x7f85 0x9402 0xee5 0x818c 0x93f1 0xf26 0x8392 0x93df 0xf67 0x8598 0x93ce 0xfad 0x879e 0x93bd 0x1018 0x89a4 0x93ab 0x1084 0x8bab 0x93a1 0x1103 0x8db1 0x938d 0x1177 0x8fb7 0x9373 0x1204 0x91bd 0x9359 0x12a9 0x93c3 0x933e 0x1340 0x95c9 0x931b 0x13d8 0x97d0 0x92f0 0x1485 0x99d6 0x92c4 0x1557 0x9bdc 0x9299 0x162f 0x9de2 0x926e 0x1743 0x9fe8 0x923c 0x1889 0xa1ef 0x91fc 0x19d1 0xa3f5 0x91b7 0x1b19 0xa5fb 0x9172 0x1c88 0xa801 0x912d 0x1e35 0xaa07 0x90e1 0x2006 0xac0d 0x908e 0x2218 0xae14 0x9048 0x2486 0xb01a 0x901c 0x2775 0xb220 0x9002 0x2b0c 0xb426 0x8fe8 0x2f59 0xb62c 0x8fc5 0x3426 0xb833 0x8f94 0x38e2 0xba39 0x8f29 0x3cb9 0xbc3f 0x8e20 0x3fe8 0xbe45 0x8c51 0x43fe 0xc04b 0x89d6 0x4702 0xc251 0x8635 0x3e2a 0xc458 0x8014 0x2f0d 0xc65e 0x7ff8 0x2ee0 0xc864 0x7ff8 0x2ee0>;
			battery1_profile_t3_col = <0x3>;
			battery1_profile_t3_num = <0x64>;
			battery1_profile_t4 = <0x0 0xaac8 0x2742 0x206 0xaa1b 0x2742 0x40c 0xa976 0x27c1 0x613 0xa8d8 0x27e2 0x819 0xa841 0x27c1 0xa1f 0xa7ad 0x2796 0xc25 0xa71a 0x2760 0xe2b 0xa690 0x2705 0x1031 0xa606 0x266e 0x1238 0xa57c 0x25d7 0x143e 0xa4ff 0x251f 0x1644 0xa481 0x2450 0x184a 0xa407 0x238b 0x1a50 0xa394 0x22de 0x1c57 0xa31c 0x223a 0x1e5d 0xa2ac 0x21ce 0x2063 0xa23a 0x218a 0x2269 0xa1c9 0x2137 0x246f 0xa159 0x20e1 0x2675 0xa0e8 0x2096 0x287c 0xa07b 0x205d 0x2a82 0xa015 0x2042 0x2c88 0x9fb6 0x206a 0x2e8e 0x9f4e 0x203f 0x3094 0x9ed8 0x2027 0x329b 0x9e58 0x1ff2 0x34a1 0x9dd6 0x1fbd 0x36a7 0x9d53 0x1f88 0x38ad 0x9cd1 0x1f48 0x3ab3 0x9c52 0x1f0c 0x3cb9 0x9be1 0x1ef6 0x3ec0 0x9b82 0x1ee0 0x40c6 0x9b23 0x1ecb 0x42cc 0x9ac4 0x1eb5 0x44d2 0x9a65 0x1e95 0x46d8 0x9a06 0x1e71 0x48df 0x99a7 0x1e54 0x4ae5 0x9947 0x1e14 0x4ceb 0x98de 0x1dbc 0x4ef1 0x9885 0x1d8b 0x50f7 0x9829 0x1d41 0x52fd 0x97d3 0x1cf6 0x5504 0x9785 0x1cbe 0x570a 0x9738 0x1ca7 0x5910 0x96eb 0x1cd4 0x5b16 0x96a6 0x1d15 0x5d1c 0x9668 0x1d7d 0x5f23 0x962c 0x1dc8 0x6129 0x95ef 0x1e17 0x632f 0x95b6 0x1e78 0x6535 0x9582 0x1ede 0x673b 0x9550 0x1f37 0x6941 0x9524 0x1fa3 0x6b48 0x94f9 0x1ffa 0x6d4e 0x94d5 0x2062 0x6f54 0x94b3 0x20bf 0x715a 0x9495 0x2121 0x7360 0x947b 0x218d 0x7567 0x9462 0x2206 0x776d 0x9451 0x22b3 0x7973 0x9440 0x2335 0x7b79 0x9427 0x23dd 0x7d7f 0x9413 0x249a 0x7f85 0x9402 0x255d 0x818c 0x93f1 0x263b 0x8392 0x93df 0x273e 0x8598 0x93cd 0x2844 0x879e 0x93b3 0x295c 0x89a4 0x93a1 0x2a9e 0x8bab 0x9389 0x2be6 0x8db1 0x936f 0x2d3a 0x8fb7 0x9355 0x2eaa 0x91bd 0x933b 0x302e 0x93c3 0x9320 0x31af 0x95c9 0x92fd 0x331d 0x97d0 0x92da 0x3461 0x99d6 0x92b0 0x35a4 0x9bdc 0x9285 0x36c9 0x9de2 0x9255 0x37d6 0x9fe8 0x9221 0x38c1 0xa1ef 0x91ea 0x3985 0xa3f5 0x91ae 0x3a46 0xa5fb 0x9171 0x3af2 0xa801 0x912d 0x3b8b 0xaa07 0x90e1 0x3c44 0xac0d 0x9099 0x3d14 0xae14 0x9060 0x3e14 0xb01a 0x903a 0x3f6b 0xb220 0x9020 0x4135 0xb426 0x9006 0x4392 0xb62c 0x8fec 0x4741 0xb833 0x8fc3 0x4c8e 0xba39 0x8f58 0x52d4 0xbc3f 0x8e51 0x527b 0xbe45 0x8c5d 0x4db5 0xc04b 0x8993 0x4722 0xc251 0x8912 0x453d 0xc458 0x8912 0x453d 0xc65e 0x8912 0x453d 0xc864 0x8912 0x453d>;
			battery1_profile_t4_col = <0x3>;
			battery1_profile_t4_num = <0x64>;
			g_FG_PSEUDO100_cv4270 = <0x58 0x58 0x64 0x64 0x58 0x59 0x64 0x64 0x58 0x58 0x64 0x64 0x58 0x58 0x64 0x64 0x58 0x58 0x64 0x64 0x64 0x64 0x64 0x64 0x64 0x64 0x64 0x64 0x64 0x64 0x64 0x64 0x64 0x64 0x64 0x64 0x64 0x64 0x64 0x64>;
			g_FG_PSEUDO100_cv4320 = <0x5a 0x5c 0x64 0x64 0x5a 0x5b 0x64 0x64 0x5a 0x5b 0x64 0x64 0x5a 0x5b 0x64 0x64 0x5a 0x5b 0x64 0x64 0x64 0x64 0x64 0x64 0x64 0x64 0x64 0x64 0x64 0x64 0x64 0x64 0x64 0x64 0x64 0x64 0x64 0x64 0x64 0x64>;
			g_FG_PSEUDO100_cv4340 = <0x5b 0x5c 0x64 0x64 0x5b 0x5b 0x64 0x64 0x5b 0x5b 0x64 0x64 0x5b 0x5b 0x64 0x64 0x5b 0x5b 0x64 0x64 0x64 0x64 0x64 0x64 0x64 0x64 0x64 0x64 0x64 0x64 0x64 0x64 0x64 0x64 0x64 0x64 0x64 0x64 0x64 0x64>;
			g_FG_PSEUDO100_cv4360 = <0x61 0x61 0x64 0x64 0x61 0x61 0x64 0x64 0x61 0x61 0x64 0x64 0x60 0x60 0x64 0x64 0x60 0x60 0x64 0x64 0x64 0x64 0x64 0x64 0x64 0x64 0x64 0x64 0x64 0x64 0x64 0x64 0x64 0x64 0x64 0x64 0x64 0x64 0x64 0x64>;
			g_FG_PSEUDO100_cv4380 = <0x62 0x62 0x64 0x64 0x62 0x62 0x64 0x64 0x62 0x62 0x64 0x64 0x61 0x61 0x64 0x64 0x61 0x61 0x64 0x64 0x64 0x64 0x64 0x64 0x64 0x64 0x64 0x64 0x64 0x64 0x64 0x64 0x64 0x64 0x64 0x64 0x64 0x64 0x64 0x64>;
			io-channel-names = "batteryID-channel";
			io-channels = <0xffffffff 0x5>;
			wt,batt-cycle-ranges = <0x0 0x12b 0x42d560 0x12c 0x18f 0x428740 0x190 0x2bb 0x423920 0x2bc 0x3e7 0x41eb00 0x3e8 0xf423f 0x4127b0>;
		};
	};

	fragment@50 {
		target = <0xffffffff>;

		__overlay__ {
			interrupt-parent = <0xffffffff>;
			interrupts = <0xe 0x8>;
			status = "okay";
		};
	};

	fragment@51 {
		target = <0xffffffff>;

		__overlay__ {
			interrupt-parent = <0xffffffff>;
			interrupts = <0x54 0x1>;
			status = "okay";
		};
	};

	fragment@52 {
		target = <0xffffffff>;

		__overlay__ {
			compatible = "mediatek,md1_sim1_hot_plug_eint-eint";
			debounce = <0x0 0xc350>;
			dedicated = <0x0 0x0>;
			interrupts = <0x0 0x8>;
			sockettype = <0x0 0x0>;
			src_pin = <0x0 0x1>;
			status = "okay";
		};
	};

	fragment@53 {
		target = <0xffffffff>;

		__overlay__ {
			regulator-default-on = <0x1>;
			regulator-name = "vcamio";
			status = "okay";
		};
	};

	fragment@54 {
		target = <0xffffffff>;

		__overlay__ {
			regulator-default-on = <0x1>;
			regulator-name = "vtp";
			status = "okay";
		};
	};

	fragment@55 {
		target = <0xffffffff>;

		__overlay__ {
			status = "okay";
			vcamaf-supply = <0xffffffff>;
			vcamd_sub2-supply = <0xffffffff>;
			vcamio-supply = <0xffffffff>;
			vcamio_main2-supply = <0xffffffff>;
			vcamio_sub-supply = <0xffffffff>;
		};
	};

	fragment@56 {
		target = <0xffffffff>;

		__overlay__ {
			mediatek,kpd-hw-dl-key0 = <0x1>;
			mediatek,kpd-hw-dl-key1 = <0x11>;
			mediatek,kpd-hw-dl-key2 = <0x8>;
			mediatek,kpd-hw-factory-key = <0x11>;
			mediatek,kpd-hw-init-map = <0x0 0x73 0x0 0x0 0x0 0x0 0x0 0x0 0x0 0x0 0x0 0x0 0x0 0x0 0x0 0x0 0x0 0x0 0x0 0x0 0x0 0x0 0x0 0x0 0x0 0x0 0x0 0x0 0x0 0x0 0x0 0x0 0x0 0x0 0x0 0x0 0x0 0x0 0x0 0x0 0x0 0x0 0x0 0x0 0x0 0x0 0x0 0x0 0x0 0x0 0x0 0x0 0x0 0x0 0x0 0x0 0x0 0x0 0x0 0x0 0x0 0x0 0x0 0x0 0x0 0x0 0x0 0x0 0x0 0x0 0x0 0x0>;
			mediatek,kpd-hw-map-num = <0x48>;
			mediatek,kpd-hw-pwrkey = <0x8>;
			mediatek,kpd-hw-recovery-key = <0x1>;
			mediatek,kpd-hw-rstkey = <0x11>;
			mediatek,kpd-key-debounce = <0x400>;
			mediatek,kpd-pwkey-gpio-din = <0x0>;
			mediatek,kpd-pwrkey-eint-gpio = <0x0>;
			mediatek,kpd-sw-pwrkey = <0x74>;
			mediatek,kpd-sw-rstkey = <0x72>;
			mediatek,kpd-use-extend-type = <0x0>;
			status = "okay";
		};
	};

	fragment@57 {
		target = <0xffffffff>;

		__overlay__ {

			fs16xx@34 {
				compatible = "foursemi,fs16xx";
				fsm,rst-gpio = <0xffffffff 0xa9 0x0>;
				reg = <0x34>;
				status = "okay";
			};
		};
	};

	fragment@6 {
		target = <0xffffffff>;

		__overlay__ {

			chg {
				cv = <0x432380>;
				ieoc = <0x3d090>;
			};
		};
	};

	fragment@7 {
		target = <0xffffffff>;

		__overlay__ {
			ac_charger_current = <0x1e8480>;
			ac_charger_input_current = <0x1e8480>;
			afc_charger_current = <0x2dc6c0>;
			afc_charger_input_current = <0x197b70>;
			afc_data_gpio = <0xffffffff 0xd 0x0>;
			afc_data_gpio_num = <0xd>;
			afc_ichg_level_threshold = <0xf4240>;
			afc_max_charger_voltage = <0x895440>;
			afc_min_charger_voltage = <0x401640>;
			afc_pre_input_curret = <0x7a120>;
			afc_start_battery_soc = <0x0>;
			afc_stop_battery_soc = <0x55>;
			afc_switch_gpio = <0xffffffff 0x8b 0x0>;
			afc_switch_gpio_num = <0x8b>;
			battery_cv = <0x432380>;
			enable_afc;
			enable_min_charge_temp;
			enable_pe_2;
			enable_sw_jeita;
			jeita_temp_above_t4_cc = <0x0>;
			jeita_temp_above_t4_cv = <0x3e8fa0>;
			jeita_temp_below_t0_cc = <0x0>;
			jeita_temp_below_t0_cv = <0x432380>;
			jeita_temp_t0_to_t1_cc = <0x61a80>;
			jeita_temp_t0_to_t1_cv = <0x432380>;
			jeita_temp_t1_to_t2_cc = <0x124f80>;
			jeita_temp_t1_to_t2_cv = <0x432380>;
			jeita_temp_t2_to_t3_cc = <0x1e8480>;
			jeita_temp_t2_to_t3_cv = <0x432380>;
			jeita_temp_t3_to_t4_cc = <0x155cc0>;
			jeita_temp_t3_to_t4_cv = <0x3e8fa0>;
			max_charge_temp = <0x3c>;
			max_charge_temp_minus_x_degree = <0x3c>;
			max_charger_voltage = <0x989680>;
			min_charge_temp = <0x0>;
			min_charge_temp_plus_x_degree = <0x0>;
			pd_vbus_upper_bound = <0x895440>;
			pinctrl-0 = <0x1>;
			pinctrl-1 = <0x2>;
			pinctrl-names = "active", "sleep";
			status = "okay";
			ta_ac_charger_current = <0x2dc6c0>;
			temp_neg_10_thres = <0x0>;
			temp_t0_thres = <0x1>;
			temp_t0_thres_plus_x_degree = <0x1>;
			temp_t1_thres = <0x5>;
			temp_t1_thres_plus_x_degree = <0x6>;
			temp_t2_thres = <0xa>;
			temp_t2_thres_plus_x_degree = <0xb>;
			temp_t3_thres = <0x2d>;
			temp_t3_thres_minus_x_degree = <0x2c>;
			temp_t4_thres = <0x37>;
			temp_t4_thres_minus_x_degree = <0x36>;
		};
	};

	fragment@8 {
		target = <0xffffffff>;

		__overlay__ {

			active {
				phandle = <0x1>;

				pins_cmd0_dat {
					bias-disable;
					drive-strength = <0x4>;
					pinmux = <0xd00>;
				};
			};

			sleep {
				phandle = <0x2>;

				pins_cmd0_dat {
					bias-disable;
					drive-strength = <0x4>;
					input-enable;
					pinmux = <0xd00>;
				};
			};
		};
	};

	fragment@9 {
		target = <0xffffffff>;

		__overlay__ {

			lcd_bias_enn0_gpio {
				phandle = <0x6>;

				pins_cmd_dat {
					output-low;
					pinmux = <0x8a00>;
					slew-rate = <0x1>;
				};
			};

			lcd_bias_enn1_gpio {
				phandle = <0x5>;

				pins_cmd_dat {
					output-high;
					pinmux = <0x8a00>;
					slew-rate = <0x1>;
				};
			};

			lcd_bias_enp0_gpio {
				phandle = <0x4>;

				pins_cmd_dat {
					output-low;
					pinmux = <0x8900>;
					slew-rate = <0x1>;
				};
			};

			lcd_bias_enp1_gpio {
				phandle = <0x3>;

				pins_cmd_dat {
					output-high;
					pinmux = <0x8900>;
					slew-rate = <0x1>;
				};
			};

			lcm_dsi_te {
				phandle = <0x9>;

				pins_cmd_dat {
					pinmux = <0x5401>;
				};
			};

			lcm_rst_out0_gpio {
				phandle = <0x8>;

				pins_cmd_dat {
					output-low;
					pinmux = <0x5600>;
					slew-rate = <0x1>;
				};
			};

			lcm_rst_out1_gpio {
				phandle = <0x7>;

				pins_cmd_dat {
					output-high;
					pinmux = <0x5600>;
					slew-rate = <0x1>;
				};
			};
		};
	};

	fragment@model {
		target-path = [2f 00];

		__overlay__ {

			usb_notifier {
				compatible = "samsung,usb-notifier";
			};
		};
	};

	fragment@smd {
		target-path = [2f 00];

		__overlay__ {

			dev_ril_bridge_pdata {
				compatible = "samsung,dev_ril_bridge_pdata";
				status = "okay";
			};

			mif_pdata {
				compatible = "sec_modem,modem_pdata";
				mif,ipc_version = <0x32>;
				mif,link_attrs = <0x7c8>;
				mif,link_name = "shmem";
				mif,link_types = <0x200>;
				mif,modem_net = <0x0>;
				mif,modem_type = <0xa>;
				mif,name = "MTK-common";
				mif,num_iodevs = <0x5>;
				mif,use_handover = <0x0>;
				status = "okay";

				iodevs {

					io_device_0 {
						iod,app = "RIL";
						iod,attrs = <0x2>;
						iod,format = <0x0>;
						iod,id = <0xec>;
						iod,io_type = <0x0>;
						iod,links = <0x200>;
						iod,minor = <0x1e>;
						iod,name = "umts_boot0";
					};

					io_device_1 {
						iod,app = "RIL";
						iod,attrs = <0x2>;
						iod,format = <0x0>;
						iod,id = <0xec>;
						iod,io_type = <0x0>;
						iod,links = <0x200>;
						iod,minor = <0x1c>;
						iod,name = "umts_ipc0";
					};

					io_device_2 {
						iod,app = "RIL";
						iod,attrs = <0x2>;
						iod,format = <0x0>;
						iod,id = <0xec>;
						iod,io_type = <0x0>;
						iod,links = <0x200>;
						iod,minor = <0x1d>;
						iod,name = "umts_ipc1";
					};

					io_device_3 {
						iod,app = "smdexe";
						iod,attrs = <0x2>;
						iod,format = <0x1>;
						iod,id = <0xec>;
						iod,io_type = <0x0>;
						iod,links = <0x200>;
						iod,minor = <0x3>;
						iod,name = "umts_router";
					};

					io_device_4 {
						iod,app = "CSVT";
						iod,attrs = <0x2>;
						iod,format = <0x1>;
						iod,io_type = <0x0>;
						iod,links = <0x200>;
						iod,minor = <0x1e>;
						iod,name = "umts_csd";
					};
				};
			};
		};
	};
};
